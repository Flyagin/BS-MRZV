
#include "gui_header.h"
#include "header_mal.h"

/*********************************************************************
*
*       Meas. pages resources
*
*/
static const GUI_WIDGET_CREATE_INFO _aMeasPgCreate1[] = {
  { WINDOW_CreateIndirect, "Dialog 1", ID_MEAS_PG_0, MEAS_PG_X, MEAS_PG_Y, MEAS_PG_WIDTH, MEAS_PG_HEIGHT, 0 },
  
  { TEXT_CreateIndirect, "3I0", ID_FIRST_FOURIER_MEAS, 10, 5, 50, MEAS_LABEL_HEIGHT, 0, 0x0, 0 },
  { TEXT_CreateIndirect, "IA", ID_FIRST_FOURIER_MEAS + 1, 10, 20, 50, MEAS_LABEL_HEIGHT, 0, 0x0, 0 },
  { TEXT_CreateIndirect, "IB", ID_FIRST_FOURIER_MEAS + 2, 10, 35, 50, MEAS_LABEL_HEIGHT, 0, 0x0, 0 },
  { TEXT_CreateIndirect, "IC", ID_FIRST_FOURIER_MEAS + 3, 10, 50, 50, MEAS_LABEL_HEIGHT, 0, 0x0, 0 },
  { TEXT_CreateIndirect, "3U0", ID_FIRST_FOURIER_MEAS + 4, 10, 65, 50, MEAS_LABEL_HEIGHT, 0, 0x0, 0 },
  { TEXT_CreateIndirect, "UA", ID_FIRST_FOURIER_MEAS + 5, 10, 80, 50, MEAS_LABEL_HEIGHT, 0, 0x0, 0 },
  { TEXT_CreateIndirect, "UB", ID_FIRST_FOURIER_MEAS + 6, 10, 95, 50, MEAS_LABEL_HEIGHT, 0, 0x0, 0 },
  { TEXT_CreateIndirect, "UC", ID_FIRST_FOURIER_MEAS + 7, 10, 110, 50, MEAS_LABEL_HEIGHT, 0, 0x0, 0 },
  { TEXT_CreateIndirect, "ISYN", ID_FIRST_FOURIER_MEAS + 8, 10, 125, 50, MEAS_LABEL_HEIGHT, 0, 0x0, 0 },
  
  { TEXT_CreateIndirect, "USYN", ID_FIRST_FOURIER_MEAS + 9, 155, 5, 50, MEAS_LABEL_HEIGHT, 0, 0x0, 0 },
  { TEXT_CreateIndirect, "UBC_TN2", ID_FIRST_FOURIER_MEAS + 10, 155, 20, 50, MEAS_LABEL_HEIGHT, 0, 0x0, 0 },
  { TEXT_CreateIndirect, "I2", ID_FIRST_FOURIER_MEAS + 11, 155, 35, 50, MEAS_LABEL_HEIGHT, 0, 0x0, 0 },
  { TEXT_CreateIndirect, "U2", ID_FIRST_FOURIER_MEAS + 12, 155, 50, 50, MEAS_LABEL_HEIGHT, 0, 0x0, 0 },
  { TEXT_CreateIndirect, "I1", ID_FIRST_FOURIER_MEAS + 13, 155, 65, 50, MEAS_LABEL_HEIGHT, 0, 0x0, 0 },
  { TEXT_CreateIndirect, "U1", ID_FIRST_FOURIER_MEAS + 14, 155, 80, 50, MEAS_LABEL_HEIGHT, 0, 0x0, 0 },
  { TEXT_CreateIndirect, "I0", ID_FIRST_FOURIER_MEAS + 15, 155, 95, 50, MEAS_LABEL_HEIGHT, 0, 0x0, 0 },
  
  { TEXT_CreateIndirect, "=", ID_FIRST_FOURIER_MEAS + 16, 40, 5, 10, MEAS_LABEL_HEIGHT, 0, 0x0, 0 },
  { TEXT_CreateIndirect, "=", ID_FIRST_FOURIER_MEAS + 17, 40, 20, 10, MEAS_LABEL_HEIGHT, 0, 0x0, 0 },
  { TEXT_CreateIndirect, "=", ID_FIRST_FOURIER_MEAS + 18, 40, 35, 10, MEAS_LABEL_HEIGHT, 0, 0x0, 0 },
  { TEXT_CreateIndirect, "=", ID_FIRST_FOURIER_MEAS + 19, 40, 50, 10, MEAS_LABEL_HEIGHT, 0, 0x0, 0 },
  { TEXT_CreateIndirect, "=", ID_FIRST_FOURIER_MEAS + 20, 40, 65, 10, MEAS_LABEL_HEIGHT, 0, 0x0, 0 },
  { TEXT_CreateIndirect, "=", ID_FIRST_FOURIER_MEAS + 21, 40, 80, 10, MEAS_LABEL_HEIGHT, 0, 0x0, 0 },
  { TEXT_CreateIndirect, "=", ID_FIRST_FOURIER_MEAS + 22, 40, 95, 10, MEAS_LABEL_HEIGHT, 0, 0x0, 0 },
  { TEXT_CreateIndirect, "=", ID_FIRST_FOURIER_MEAS + 23, 40, 110, 10, MEAS_LABEL_HEIGHT, 0, 0x0, 0 },
  { TEXT_CreateIndirect, "=", ID_FIRST_FOURIER_MEAS + 24, 40, 125, 10, MEAS_LABEL_HEIGHT, 0, 0x0, 0 },
  
  { TEXT_CreateIndirect, "=", ID_FIRST_FOURIER_MEAS + 25, 205, 5, 10, MEAS_LABEL_HEIGHT, 0, 0x0, 0 },
  { TEXT_CreateIndirect, "=", ID_FIRST_FOURIER_MEAS + 26, 205, 20, 10, MEAS_LABEL_HEIGHT, 0, 0x0, 0 },
  { TEXT_CreateIndirect, "=", ID_FIRST_FOURIER_MEAS + 27, 205, 35, 10, MEAS_LABEL_HEIGHT, 0, 0x0, 0 },
  { TEXT_CreateIndirect, "=", ID_FIRST_FOURIER_MEAS + 28, 205, 50, 10, MEAS_LABEL_HEIGHT, 0, 0x0, 0 },
  { TEXT_CreateIndirect, "=", ID_FIRST_FOURIER_MEAS + 29, 205, 65, 10, MEAS_LABEL_HEIGHT, 0, 0x0, 0 },
  { TEXT_CreateIndirect, "=", ID_FIRST_FOURIER_MEAS + 30, 205, 80, 10, MEAS_LABEL_HEIGHT, 0, 0x0, 0 },
  { TEXT_CreateIndirect, "=", ID_FIRST_FOURIER_MEAS + 31, 205, 95, 10, MEAS_LABEL_HEIGHT, 0, 0x0, 0 },
  
  { TEXT_CreateIndirect, "0", ID_FIRST_FOURIER_MEAS + 32, 55, 5, 90, MEAS_LABEL_HEIGHT, 0, 0x0, 0 },
  { TEXT_CreateIndirect, "0", ID_FIRST_FOURIER_MEAS + 33, 55, 20, 90, MEAS_LABEL_HEIGHT, 0, 0x0, 0 },
  { TEXT_CreateIndirect, "0", ID_FIRST_FOURIER_MEAS + 34, 55, 35, 90, MEAS_LABEL_HEIGHT, 0, 0x0, 0 },
  { TEXT_CreateIndirect, "0", ID_FIRST_FOURIER_MEAS + 35, 55, 50, 90, MEAS_LABEL_HEIGHT, 0, 0x0, 0 },
  { TEXT_CreateIndirect, "0", ID_FIRST_FOURIER_MEAS + 36, 55, 65, 90, MEAS_LABEL_HEIGHT, 0, 0x0, 0 },
  { TEXT_CreateIndirect, "0", ID_FIRST_FOURIER_MEAS + 37, 55, 80, 90, MEAS_LABEL_HEIGHT, 0, 0x0, 0 },
  { TEXT_CreateIndirect, "0", ID_FIRST_FOURIER_MEAS + 38, 55, 95, 90, MEAS_LABEL_HEIGHT, 0, 0x0, 0 },
  { TEXT_CreateIndirect, "0", ID_FIRST_FOURIER_MEAS + 39, 55, 110, 90, MEAS_LABEL_HEIGHT, 0, 0x0, 0 },
  { TEXT_CreateIndirect, "0", ID_FIRST_FOURIER_MEAS + 40, 55, 125, 90, MEAS_LABEL_HEIGHT, 0, 0x0, 0 },
  
  { TEXT_CreateIndirect, "0", ID_FIRST_FOURIER_MEAS + 41, 220, 5, 90, MEAS_LABEL_HEIGHT, 0, 0x0, 0 },
  { TEXT_CreateIndirect, "0", ID_FIRST_FOURIER_MEAS + 42, 220, 20, 90, MEAS_LABEL_HEIGHT, 0, 0x0, 0 },
  { TEXT_CreateIndirect, "0", ID_FIRST_FOURIER_MEAS + 43, 220, 35, 90, MEAS_LABEL_HEIGHT, 0, 0x0, 0 },
  { TEXT_CreateIndirect, "0", ID_FIRST_FOURIER_MEAS + 44, 220, 50, 90, MEAS_LABEL_HEIGHT, 0, 0x0, 0 },
  { TEXT_CreateIndirect, "0", ID_FIRST_FOURIER_MEAS + 45, 220, 65, 90, MEAS_LABEL_HEIGHT, 0, 0x0, 0 },
  { TEXT_CreateIndirect, "0", ID_FIRST_FOURIER_MEAS + 46, 220, 80, 90, MEAS_LABEL_HEIGHT, 0, 0x0, 0 },
  { TEXT_CreateIndirect, "0", ID_LAST_FOURIER_MEAS, 220, 95, 90, MEAS_LABEL_HEIGHT, 0, 0x0, 0 }
};

static const GUI_WIDGET_CREATE_INFO _aMeasPgCreate2[] = {
  { WINDOW_CreateIndirect, "Dialog 2", ID_MEAS_PG_1, MEAS_PG_X, MEAS_PG_Y, MEAS_PG_WIDTH, MEAS_PG_HEIGHT, 0 },
  
  { TEXT_CreateIndirect, "3I0", ID_FIRST_SUM_EQUATION_MEAS, 10, 5, 50, MEAS_LABEL_HEIGHT, 0, 0x0, 0 },
  { TEXT_CreateIndirect, "IA", ID_FIRST_SUM_EQUATION_MEAS + 1, 10, 20, 50, MEAS_LABEL_HEIGHT, 0, 0x0, 0 },
  { TEXT_CreateIndirect, "IB", ID_FIRST_SUM_EQUATION_MEAS + 2, 10, 35, 50, MEAS_LABEL_HEIGHT, 0, 0x0, 0 },
  { TEXT_CreateIndirect, "IC", ID_FIRST_SUM_EQUATION_MEAS + 3, 10, 50, 50, MEAS_LABEL_HEIGHT, 0, 0x0, 0 },
  { TEXT_CreateIndirect, "3U0", ID_FIRST_SUM_EQUATION_MEAS + 4, 10, 65, 50, MEAS_LABEL_HEIGHT, 0, 0x0, 0 },
  { TEXT_CreateIndirect, "UA", ID_FIRST_SUM_EQUATION_MEAS + 5, 10, 80, 50, MEAS_LABEL_HEIGHT, 0, 0x0, 0 },
  { TEXT_CreateIndirect, "UB", ID_FIRST_SUM_EQUATION_MEAS + 6, 10, 95, 50, MEAS_LABEL_HEIGHT, 0, 0x0, 0 },
  { TEXT_CreateIndirect, "UC", ID_FIRST_SUM_EQUATION_MEAS + 7, 10, 110, 50, MEAS_LABEL_HEIGHT, 0, 0x0, 0 },
  { TEXT_CreateIndirect, "ISYN", ID_FIRST_SUM_EQUATION_MEAS + 8, 10, 125, 50, MEAS_LABEL_HEIGHT, 0, 0x0, 0 },
  
  { TEXT_CreateIndirect, "USYN", ID_FIRST_SUM_EQUATION_MEAS + 9, 155, 5, 50, MEAS_LABEL_HEIGHT, 0, 0x0, 0 },
  { TEXT_CreateIndirect, "UBC_TN2", ID_FIRST_SUM_EQUATION_MEAS + 10, 155, 20, 50, MEAS_LABEL_HEIGHT, 0, 0x0, 0 },
  
  { TEXT_CreateIndirect, "=", ID_FIRST_SUM_EQUATION_MEAS + 11, 40, 5, 10, MEAS_LABEL_HEIGHT, 0, 0x0, 0 },
  { TEXT_CreateIndirect, "=", ID_FIRST_SUM_EQUATION_MEAS + 12, 40, 20, 10, MEAS_LABEL_HEIGHT, 0, 0x0, 0 },
  { TEXT_CreateIndirect, "=", ID_FIRST_SUM_EQUATION_MEAS + 13, 40, 35, 10, MEAS_LABEL_HEIGHT, 0, 0x0, 0 },
  { TEXT_CreateIndirect, "=", ID_FIRST_SUM_EQUATION_MEAS + 14, 40, 50, 10, MEAS_LABEL_HEIGHT, 0, 0x0, 0 },
  { TEXT_CreateIndirect, "=", ID_FIRST_SUM_EQUATION_MEAS + 15, 40, 65, 10, MEAS_LABEL_HEIGHT, 0, 0x0, 0 },
  { TEXT_CreateIndirect, "=", ID_FIRST_SUM_EQUATION_MEAS + 16, 40, 80, 10, MEAS_LABEL_HEIGHT, 0, 0x0, 0 },
  { TEXT_CreateIndirect, "=", ID_FIRST_SUM_EQUATION_MEAS + 17, 40, 95, 10, MEAS_LABEL_HEIGHT, 0, 0x0, 0 },
  { TEXT_CreateIndirect, "=", ID_FIRST_SUM_EQUATION_MEAS + 18, 40, 110, 10, MEAS_LABEL_HEIGHT, 0, 0x0, 0 },
  { TEXT_CreateIndirect, "=", ID_FIRST_SUM_EQUATION_MEAS + 19, 40, 125, 10, MEAS_LABEL_HEIGHT, 0, 0x0, 0 },
  
  { TEXT_CreateIndirect, "=", ID_FIRST_SUM_EQUATION_MEAS + 20, 205, 5, 10, MEAS_LABEL_HEIGHT, 0, 0x0, 0 },
  { TEXT_CreateIndirect, "=", ID_FIRST_SUM_EQUATION_MEAS + 21, 205, 20, 10, MEAS_LABEL_HEIGHT, 0, 0x0, 0 },
  
  { TEXT_CreateIndirect, "0", ID_FIRST_SUM_EQUATION_MEAS + 22, 55, 5, 90, MEAS_LABEL_HEIGHT, 0, 0x0, 0 },
  { TEXT_CreateIndirect, "0", ID_FIRST_SUM_EQUATION_MEAS + 23, 55, 20, 90, MEAS_LABEL_HEIGHT, 0, 0x0, 0 },
  { TEXT_CreateIndirect, "0", ID_FIRST_SUM_EQUATION_MEAS + 24, 55, 35, 90, MEAS_LABEL_HEIGHT, 0, 0x0, 0 },
  { TEXT_CreateIndirect, "0", ID_FIRST_SUM_EQUATION_MEAS + 25, 55, 50, 90, MEAS_LABEL_HEIGHT, 0, 0x0, 0 },
  { TEXT_CreateIndirect, "0", ID_FIRST_SUM_EQUATION_MEAS + 26, 55, 65, 90, MEAS_LABEL_HEIGHT, 0, 0x0, 0 },
  { TEXT_CreateIndirect, "0", ID_FIRST_SUM_EQUATION_MEAS + 27, 55, 80, 90, MEAS_LABEL_HEIGHT, 0, 0x0, 0 },
  { TEXT_CreateIndirect, "0", ID_FIRST_SUM_EQUATION_MEAS + 28, 55, 95, 90, MEAS_LABEL_HEIGHT, 0, 0x0, 0 },
  { TEXT_CreateIndirect, "0", ID_FIRST_SUM_EQUATION_MEAS + 29, 55, 110, 90, MEAS_LABEL_HEIGHT, 0, 0x0, 0 },
  { TEXT_CreateIndirect, "0", ID_FIRST_SUM_EQUATION_MEAS + 30, 55, 125, 90, MEAS_LABEL_HEIGHT, 0, 0x0, 0 },
  
  { TEXT_CreateIndirect, "0", ID_FIRST_SUM_EQUATION_MEAS + 31, 220, 5, 90, MEAS_LABEL_HEIGHT, 0, 0x0, 0 },
  { TEXT_CreateIndirect, "0", ID_LAST_SUM_EQUATION_MEAS, 220, 20, 90, MEAS_LABEL_HEIGHT, 0, 0x0, 0 }
};

static const GUI_WIDGET_CREATE_INFO _aMeasPgCreate3[] = {
  { WINDOW_CreateIndirect, "Dialog 3", ID_MEAS_PG_2, MEAS_PG_X, MEAS_PG_Y, MEAS_PG_WIDTH, MEAS_PG_HEIGHT, 0 },
  
  { TEXT_CreateIndirect, "¿ IC-UBC", ID_FIRST_ANGLES_MEAS, 10, 5, 60, MEAS_LABEL_HEIGHT, 0, 0x0, 0 },
  { TEXT_CreateIndirect, "¿ IB-UCA", ID_FIRST_ANGLES_MEAS + 1, 10, 20, 60, MEAS_LABEL_HEIGHT, 0, 0x0, 0 },
  { TEXT_CreateIndirect, "¿ IC-UAB", ID_FIRST_ANGLES_MEAS + 2, 10, 35, 60, MEAS_LABEL_HEIGHT, 0, 0x0, 0 },
  { TEXT_CreateIndirect, "¿ I2-U2", ID_FIRST_ANGLES_MEAS + 3, 10, 50, 60, MEAS_LABEL_HEIGHT, 0, 0x0, 0 },
  { TEXT_CreateIndirect, "¿ 3I0-3U0", ID_FIRST_ANGLES_MEAS + 4, 10, 65, 60, MEAS_LABEL_HEIGHT, 0, 0x0, 0 },
  { TEXT_CreateIndirect, "ERR.ANGLE", ID_FIRST_ANGLES_MEAS + 5, 10, 80, 60, MEAS_LABEL_HEIGHT, 0, 0x0, 0 },
  { TEXT_CreateIndirect, "¿ Ia", ID_FIRST_ANGLES_MEAS + 6, 10, 95, 60, MEAS_LABEL_HEIGHT, 0, 0x0, 0 },
  { TEXT_CreateIndirect, "¿ Ib", ID_FIRST_ANGLES_MEAS + 7, 10, 110, 60, MEAS_LABEL_HEIGHT, 0, 0x0, 0 },
  
  { TEXT_CreateIndirect, "¿ Ic", ID_FIRST_ANGLES_MEAS + 8, 155, 5, 60, MEAS_LABEL_HEIGHT, 0, 0x0, 0 },
  { TEXT_CreateIndirect, "¿ Ub", ID_FIRST_ANGLES_MEAS + 9, 155, 20, 60, MEAS_LABEL_HEIGHT, 0, 0x0, 0 },
  { TEXT_CreateIndirect, "¿ Uc", ID_FIRST_ANGLES_MEAS + 10, 155, 35, 60, MEAS_LABEL_HEIGHT, 0, 0x0, 0 },
  { TEXT_CreateIndirect, "¿ 3U0", ID_FIRST_ANGLES_MEAS + 11, 155, 50, 60, MEAS_LABEL_HEIGHT, 0, 0x0, 0 },
  { TEXT_CreateIndirect, "¿ 3I0", ID_FIRST_ANGLES_MEAS + 12, 155, 65, 60, MEAS_LABEL_HEIGHT, 0, 0x0, 0 },
  { TEXT_CreateIndirect, "¿ Isyn", ID_FIRST_ANGLES_MEAS + 13, 155, 80, 60, MEAS_LABEL_HEIGHT, 0, 0x0, 0 },
  { TEXT_CreateIndirect, "¿ Usyn", ID_FIRST_ANGLES_MEAS + 14, 155, 95, 60, MEAS_LABEL_HEIGHT, 0, 0x0, 0 },
  { TEXT_CreateIndirect, "¿ Ubc_TN2", ID_FIRST_ANGLES_MEAS + 15, 155, 110, 60, MEAS_LABEL_HEIGHT, 0, 0x0, 0 },
  
  { TEXT_CreateIndirect, "=", ID_FIRST_ANGLES_MEAS + 16, 75, 5, 10, MEAS_LABEL_HEIGHT, 0, 0x0, 0 },
  { TEXT_CreateIndirect, "=", ID_FIRST_ANGLES_MEAS + 17, 75, 20, 10, MEAS_LABEL_HEIGHT, 0, 0x0, 0 },
  { TEXT_CreateIndirect, "=", ID_FIRST_ANGLES_MEAS + 18, 75, 35, 10, MEAS_LABEL_HEIGHT, 0, 0x0, 0 },
  { TEXT_CreateIndirect, "=", ID_FIRST_ANGLES_MEAS + 19, 75, 50, 10, MEAS_LABEL_HEIGHT, 0, 0x0, 0 },
  { TEXT_CreateIndirect, "=", ID_FIRST_ANGLES_MEAS + 20, 75, 65, 10, MEAS_LABEL_HEIGHT, 0, 0x0, 0 },
  { TEXT_CreateIndirect, "=", ID_FIRST_ANGLES_MEAS + 21, 75, 80, 10, MEAS_LABEL_HEIGHT, 0, 0x0, 0 },
  { TEXT_CreateIndirect, "=", ID_FIRST_ANGLES_MEAS + 22, 75, 95, 10, MEAS_LABEL_HEIGHT, 0, 0x0, 0 },
  { TEXT_CreateIndirect, "=", ID_FIRST_ANGLES_MEAS + 23, 75, 110, 10, MEAS_LABEL_HEIGHT, 0, 0x0, 0 },
  
  { TEXT_CreateIndirect, "=", ID_FIRST_ANGLES_MEAS + 24, 215, 5, 10, MEAS_LABEL_HEIGHT, 0, 0x0, 0 },
  { TEXT_CreateIndirect, "=", ID_FIRST_ANGLES_MEAS + 25, 215, 20, 10, MEAS_LABEL_HEIGHT, 0, 0x0, 0 },
  { TEXT_CreateIndirect, "=", ID_FIRST_ANGLES_MEAS + 26, 215, 35, 10, MEAS_LABEL_HEIGHT, 0, 0x0, 0 },
  { TEXT_CreateIndirect, "=", ID_FIRST_ANGLES_MEAS + 27, 215, 50, 10, MEAS_LABEL_HEIGHT, 0, 0x0, 0 },
  { TEXT_CreateIndirect, "=", ID_FIRST_ANGLES_MEAS + 28, 215, 65, 10, MEAS_LABEL_HEIGHT, 0, 0x0, 0 },
  { TEXT_CreateIndirect, "=", ID_FIRST_ANGLES_MEAS + 29, 215, 80, 10, MEAS_LABEL_HEIGHT, 0, 0x0, 0 },
  { TEXT_CreateIndirect, "=", ID_FIRST_ANGLES_MEAS + 30, 215, 95, 10, MEAS_LABEL_HEIGHT, 0, 0x0, 0 },
  { TEXT_CreateIndirect, "=", ID_FIRST_ANGLES_MEAS + 31, 215, 110, 10, MEAS_LABEL_HEIGHT, 0, 0x0, 0 },
  
  { TEXT_CreateIndirect, "0", ID_FIRST_ANGLES_MEAS + 32, 90, 5, 50, MEAS_LABEL_HEIGHT, 0, 0x0, 0 },
  { TEXT_CreateIndirect, "0", ID_FIRST_ANGLES_MEAS + 33, 90, 20, 50, MEAS_LABEL_HEIGHT, 0, 0x0, 0 },
  { TEXT_CreateIndirect, "0", ID_FIRST_ANGLES_MEAS + 34, 90, 35, 50, MEAS_LABEL_HEIGHT, 0, 0x0, 0 },
  { TEXT_CreateIndirect, "0", ID_FIRST_ANGLES_MEAS + 35, 90, 50, 50, MEAS_LABEL_HEIGHT, 0, 0x0, 0 },
  { TEXT_CreateIndirect, "0", ID_FIRST_ANGLES_MEAS + 36, 90, 65, 50, MEAS_LABEL_HEIGHT, 0, 0x0, 0 },
  { TEXT_CreateIndirect, "0", ID_FIRST_ANGLES_MEAS + 37, 90, 80, 50, MEAS_LABEL_HEIGHT, 0, 0x0, 0 },
  { TEXT_CreateIndirect, "0", ID_FIRST_ANGLES_MEAS + 38, 90, 95, 50, MEAS_LABEL_HEIGHT, 0, 0x0, 0 },
  { TEXT_CreateIndirect, "0", ID_FIRST_ANGLES_MEAS + 39, 90, 110, 50, MEAS_LABEL_HEIGHT, 0, 0x0, 0 },
  
  { TEXT_CreateIndirect, "0", ID_FIRST_ANGLES_MEAS + 40, 230, 5, 50, MEAS_LABEL_HEIGHT, 0, 0x0, 0 },
  { TEXT_CreateIndirect, "0", ID_FIRST_ANGLES_MEAS + 41, 230, 20, 50, MEAS_LABEL_HEIGHT, 0, 0x0, 0 },
  { TEXT_CreateIndirect, "0", ID_FIRST_ANGLES_MEAS + 42, 230, 35, 50, MEAS_LABEL_HEIGHT, 0, 0x0, 0 },
  { TEXT_CreateIndirect, "0", ID_FIRST_ANGLES_MEAS + 43, 230, 50, 50, MEAS_LABEL_HEIGHT, 0, 0x0, 0 },
  { TEXT_CreateIndirect, "0", ID_FIRST_ANGLES_MEAS + 44, 230, 65, 50, MEAS_LABEL_HEIGHT, 0, 0x0, 0 },
  { TEXT_CreateIndirect, "0", ID_FIRST_ANGLES_MEAS + 45, 230, 80, 50, MEAS_LABEL_HEIGHT, 0, 0x0, 0 },
  { TEXT_CreateIndirect, "0", ID_FIRST_ANGLES_MEAS + 46, 230, 95, 50, MEAS_LABEL_HEIGHT, 0, 0x0, 0 },
  { TEXT_CreateIndirect, "0", ID_LAST_ANGLES_MEAS, 230, 110, 50, MEAS_LABEL_HEIGHT, 0, 0x0, 0 }
};

static const GUI_WIDGET_CREATE_INFO _aMeasPgCommonResistances[] = {
  { WINDOW_CreateIndirect, "Common resiscances", ID_MEAS_COMMON_RESISTANCES_PG, MEAS_PG_X, MEAS_PG_Y, MEAS_PG_WIDTH, MEAS_PG_HEIGHT, 0 },
  
  { TEXT_CreateIndirect, "Zab (re)", ID_FIRST_COMMON_RESISTANCES_MEAS, 10, 5, 60, MEAS_LABEL_HEIGHT, 0, 0x0, 0 },
  { TEXT_CreateIndirect, "Zab (im)", ID_FIRST_COMMON_RESISTANCES_MEAS + 1, 10, 20, 60, MEAS_LABEL_HEIGHT, 0, 0x0, 0 },
  { TEXT_CreateIndirect, "Zbc (re)", ID_FIRST_COMMON_RESISTANCES_MEAS + 2, 10, 35, 60, MEAS_LABEL_HEIGHT, 0, 0x0, 0 },
  { TEXT_CreateIndirect, "Zbc (im)", ID_FIRST_COMMON_RESISTANCES_MEAS + 3, 10, 50, 60, MEAS_LABEL_HEIGHT, 0, 0x0, 0 },
  { TEXT_CreateIndirect, "Zca (re)", ID_FIRST_COMMON_RESISTANCES_MEAS + 4, 10, 65, 60, MEAS_LABEL_HEIGHT, 0, 0x0, 0 },
  { TEXT_CreateIndirect, "Zca (im)", ID_FIRST_COMMON_RESISTANCES_MEAS + 5, 10, 80, 60, MEAS_LABEL_HEIGHT, 0, 0x0, 0 },
  { TEXT_CreateIndirect, "Zab", ID_FIRST_COMMON_RESISTANCES_MEAS + 6, 10, 95, 60, MEAS_LABEL_HEIGHT, 0, 0x0, 0 },
  { TEXT_CreateIndirect, "Zbc", ID_FIRST_COMMON_RESISTANCES_MEAS + 7, 10, 110, 60, MEAS_LABEL_HEIGHT, 0, 0x0, 0 },
  { TEXT_CreateIndirect, "Zca", ID_FIRST_COMMON_RESISTANCES_MEAS + 8, 10, 125, 60, MEAS_LABEL_HEIGHT, 0, 0x0, 0 },
  
  { TEXT_CreateIndirect, "=", ID_FIRST_COMMON_RESISTANCES_MEAS + 9, 75, 5, 10, MEAS_LABEL_HEIGHT, 0, 0x0, 0 },
  { TEXT_CreateIndirect, "=", ID_FIRST_COMMON_RESISTANCES_MEAS + 10, 75, 20, 10, MEAS_LABEL_HEIGHT, 0, 0x0, 0 },
  { TEXT_CreateIndirect, "=", ID_FIRST_COMMON_RESISTANCES_MEAS + 11, 75, 35, 10, MEAS_LABEL_HEIGHT, 0, 0x0, 0 },
  { TEXT_CreateIndirect, "=", ID_FIRST_COMMON_RESISTANCES_MEAS + 12, 75, 50, 10, MEAS_LABEL_HEIGHT, 0, 0x0, 0 },
  { TEXT_CreateIndirect, "=", ID_FIRST_COMMON_RESISTANCES_MEAS + 13, 75, 65, 10, MEAS_LABEL_HEIGHT, 0, 0x0, 0 },
  { TEXT_CreateIndirect, "=", ID_FIRST_COMMON_RESISTANCES_MEAS + 14, 75, 80, 10, MEAS_LABEL_HEIGHT, 0, 0x0, 0 },
  { TEXT_CreateIndirect, "=", ID_FIRST_COMMON_RESISTANCES_MEAS + 15, 75, 95, 10, MEAS_LABEL_HEIGHT, 0, 0x0, 0 },
  { TEXT_CreateIndirect, "=", ID_FIRST_COMMON_RESISTANCES_MEAS + 16, 75, 110, 10, MEAS_LABEL_HEIGHT, 0, 0x0, 0 },
  { TEXT_CreateIndirect, "=", ID_FIRST_COMMON_RESISTANCES_MEAS + 17, 75, 125, 10, MEAS_LABEL_HEIGHT, 0, 0x0, 0 },
  
  { TEXT_CreateIndirect, "0", ID_FIRST_COMMON_RESISTANCES_MEAS + 18, 90, 5, 70, MEAS_LABEL_HEIGHT, 0, 0x0, 0 },
  { TEXT_CreateIndirect, "0", ID_FIRST_COMMON_RESISTANCES_MEAS + 19, 90, 20, 70, MEAS_LABEL_HEIGHT, 0, 0x0, 0 },
  { TEXT_CreateIndirect, "0", ID_FIRST_COMMON_RESISTANCES_MEAS + 20, 90, 35, 70, MEAS_LABEL_HEIGHT, 0, 0x0, 0 },
  { TEXT_CreateIndirect, "0", ID_FIRST_COMMON_RESISTANCES_MEAS + 21, 90, 50, 70, MEAS_LABEL_HEIGHT, 0, 0x0, 0 },
  { TEXT_CreateIndirect, "0", ID_FIRST_COMMON_RESISTANCES_MEAS + 22, 90, 65, 70, MEAS_LABEL_HEIGHT, 0, 0x0, 0 },
  { TEXT_CreateIndirect, "0", ID_FIRST_COMMON_RESISTANCES_MEAS + 23, 90, 80, 70, MEAS_LABEL_HEIGHT, 0, 0x0, 0 },
  { TEXT_CreateIndirect, "0", ID_FIRST_COMMON_RESISTANCES_MEAS + 24, 90, 95, 70, MEAS_LABEL_HEIGHT, 0, 0x0, 0 },
  { TEXT_CreateIndirect, "0", ID_FIRST_COMMON_RESISTANCES_MEAS + 25, 90, 110, 70, MEAS_LABEL_HEIGHT, 0, 0x0, 0 },
  { TEXT_CreateIndirect, "0", ID_LAST_COMMON_RESISTANCES_MEAS, 90, 125, 70, MEAS_LABEL_HEIGHT, 0, 0x0, 0 }
};

static const GUI_WIDGET_CREATE_INFO _aMeasPgCreate5[] = {
  { WINDOW_CreateIndirect, "Dialog 5", ID_MEAS_PG_3, MEAS_PG_X, MEAS_PG_Y, MEAS_PG_WIDTH, MEAS_PG_HEIGHT, 0 },
  
  { TEXT_CreateIndirect, "Za0 (re)", ID_FIRST_RESISTANCES_MEAS, 10, 5, 60, MEAS_LABEL_HEIGHT, 0, 0x0, 0 },
  { TEXT_CreateIndirect, "Za0 (im)", ID_FIRST_RESISTANCES_MEAS + 1, 10, 20, 60, MEAS_LABEL_HEIGHT, 0, 0x0, 0 },
  { TEXT_CreateIndirect, "Zb0 (re)", ID_FIRST_RESISTANCES_MEAS + 2, 10, 35, 60, MEAS_LABEL_HEIGHT, 0, 0x0, 0 },
  { TEXT_CreateIndirect, "Zb0 (im)", ID_FIRST_RESISTANCES_MEAS + 3, 10, 50, 60, MEAS_LABEL_HEIGHT, 0, 0x0, 0 },
  { TEXT_CreateIndirect, "Zc0 (re)", ID_FIRST_RESISTANCES_MEAS + 4, 10, 65, 60, MEAS_LABEL_HEIGHT, 0, 0x0, 0 },
  { TEXT_CreateIndirect, "Zc0 (im)", ID_FIRST_RESISTANCES_MEAS + 5, 10, 80, 60, MEAS_LABEL_HEIGHT, 0, 0x0, 0 },
  
  { TEXT_CreateIndirect, "Za0", ID_FIRST_RESISTANCES_MEAS + 6, 155, 5, 60, MEAS_LABEL_HEIGHT, 0, 0x0, 0 },
  { TEXT_CreateIndirect, "Zb0", ID_FIRST_RESISTANCES_MEAS + 7, 155, 20, 60, MEAS_LABEL_HEIGHT, 0, 0x0, 0 },
  { TEXT_CreateIndirect, "Zc0", ID_FIRST_RESISTANCES_MEAS + 8, 155, 35, 60, MEAS_LABEL_HEIGHT, 0, 0x0, 0 },
  
  { TEXT_CreateIndirect, "=", ID_FIRST_RESISTANCES_MEAS + 9, 60, 5, 10, MEAS_LABEL_HEIGHT, 0, 0x0, 0 },
  { TEXT_CreateIndirect, "=", ID_FIRST_RESISTANCES_MEAS + 10, 60, 20, 10, MEAS_LABEL_HEIGHT, 0, 0x0, 0 },
  { TEXT_CreateIndirect, "=", ID_FIRST_RESISTANCES_MEAS + 11, 60, 35, 10, MEAS_LABEL_HEIGHT, 0, 0x0, 0 },
  { TEXT_CreateIndirect, "=", ID_FIRST_RESISTANCES_MEAS + 12, 60, 50, 10, MEAS_LABEL_HEIGHT, 0, 0x0, 0 },
  { TEXT_CreateIndirect, "=", ID_FIRST_RESISTANCES_MEAS + 13, 60, 65, 10, MEAS_LABEL_HEIGHT, 0, 0x0, 0 },
  { TEXT_CreateIndirect, "=", ID_FIRST_RESISTANCES_MEAS + 14, 60, 80, 10, MEAS_LABEL_HEIGHT, 0, 0x0, 0 },
  
  { TEXT_CreateIndirect, "=", ID_FIRST_RESISTANCES_MEAS + 15, 185, 5, 10, MEAS_LABEL_HEIGHT, 0, 0x0, 0 },
  { TEXT_CreateIndirect, "=", ID_FIRST_RESISTANCES_MEAS + 16, 185, 20, 10, MEAS_LABEL_HEIGHT, 0, 0x0, 0 },
  { TEXT_CreateIndirect, "=", ID_FIRST_RESISTANCES_MEAS + 17, 185, 35, 10, MEAS_LABEL_HEIGHT, 0, 0x0, 0 },
  
  { TEXT_CreateIndirect, "0", ID_FIRST_RESISTANCES_MEAS + 18, 75, 5, 70, MEAS_LABEL_HEIGHT, 0, 0x0, 0 },
  { TEXT_CreateIndirect, "0", ID_FIRST_RESISTANCES_MEAS + 19, 75, 20, 70, MEAS_LABEL_HEIGHT, 0, 0x0, 0 },
  { TEXT_CreateIndirect, "0", ID_FIRST_RESISTANCES_MEAS + 20, 75, 35, 70, MEAS_LABEL_HEIGHT, 0, 0x0, 0 },
  { TEXT_CreateIndirect, "0", ID_FIRST_RESISTANCES_MEAS + 21, 75, 50, 70, MEAS_LABEL_HEIGHT, 0, 0x0, 0 },
  { TEXT_CreateIndirect, "0", ID_FIRST_RESISTANCES_MEAS + 22, 75, 65, 70, MEAS_LABEL_HEIGHT, 0, 0x0, 0 },
  { TEXT_CreateIndirect, "0", ID_FIRST_RESISTANCES_MEAS + 23, 75, 80, 70, MEAS_LABEL_HEIGHT, 0, 0x0, 0 },
  
  { TEXT_CreateIndirect, "0", ID_FIRST_RESISTANCES_MEAS + 24, 200, 5, 70, MEAS_LABEL_HEIGHT, 0, 0x0, 0 },
  { TEXT_CreateIndirect, "0", ID_FIRST_RESISTANCES_MEAS + 25, 200, 20, 70, MEAS_LABEL_HEIGHT, 0, 0x0, 0 },
  { TEXT_CreateIndirect, "0", ID_LAST_RESISTANCES_MEAS, 200, 35, 70, MEAS_LABEL_HEIGHT, 0, 0x0, 0 }
};

static const GUI_WIDGET_CREATE_INFO _aMeasPgCreate6[] = {
  { WINDOW_CreateIndirect, "Dialog 6", ID_MEAS_PG_4, MEAS_PG_X, MEAS_PG_Y, MEAS_PG_WIDTH, MEAS_PG_HEIGHT, 0 },
  
  { TEXT_CreateIndirect, "Ступень №1:", ID_MEAS_RES_SPEED_STAGE1_TEXT, 10, 3, 70, MEAS_LABEL_HEIGHT, 0, 0x0, 0 },
  
  { TEXT_CreateIndirect, "Za0", ID_FIRST_SPEED_RESISTANCE_CHANGE_MEAS, 10, 17, 60, MEAS_LABEL_HEIGHT, 0, 0x0, 0 },
  { TEXT_CreateIndirect, "Zb0", ID_FIRST_SPEED_RESISTANCE_CHANGE_MEAS + 1, 10, 31, 60, MEAS_LABEL_HEIGHT, 0, 0x0, 0 },
  { TEXT_CreateIndirect, "Zc0", ID_FIRST_SPEED_RESISTANCE_CHANGE_MEAS + 2, 10, 45, 60, MEAS_LABEL_HEIGHT, 0, 0x0, 0 },
  
  { TEXT_CreateIndirect, "=", ID_FIRST_SPEED_RESISTANCE_CHANGE_MEAS + 18, 60, 17, 60, MEAS_LABEL_HEIGHT, 0, 0x0, 0 },
  { TEXT_CreateIndirect, "=", ID_FIRST_SPEED_RESISTANCE_CHANGE_MEAS + 19, 60, 31, 60, MEAS_LABEL_HEIGHT, 0, 0x0, 0 },
  { TEXT_CreateIndirect, "=", ID_FIRST_SPEED_RESISTANCE_CHANGE_MEAS + 20, 60, 45, 60, MEAS_LABEL_HEIGHT, 0, 0x0, 0 },
  
  { TEXT_CreateIndirect, "0", ID_FIRST_SPEED_RESISTANCE_CHANGE_MEAS + 36, 75, 17, 60, MEAS_LABEL_HEIGHT, 0, 0x0, 0 },
  { TEXT_CreateIndirect, "0", ID_FIRST_SPEED_RESISTANCE_CHANGE_MEAS + 37, 75, 31, 60, MEAS_LABEL_HEIGHT, 0, 0x0, 0 },
  { TEXT_CreateIndirect, "0", ID_FIRST_SPEED_RESISTANCE_CHANGE_MEAS + 38, 75, 45, 60, MEAS_LABEL_HEIGHT, 0, 0x0, 0 },
  
  { TEXT_CreateIndirect, "Ступень №2:", ID_MEAS_RES_SPEED_STAGE2_TEXT, 10, 59, 70, MEAS_LABEL_HEIGHT, 0, 0x0, 0 },
  
  { TEXT_CreateIndirect, "Za0", ID_FIRST_SPEED_RESISTANCE_CHANGE_MEAS + 3, 10, 73, 60, MEAS_LABEL_HEIGHT, 0, 0x0, 0 },
  { TEXT_CreateIndirect, "Zb0", ID_FIRST_SPEED_RESISTANCE_CHANGE_MEAS + 4, 10, 87, 60, MEAS_LABEL_HEIGHT, 0, 0x0, 0 },
  { TEXT_CreateIndirect, "Zc0", ID_FIRST_SPEED_RESISTANCE_CHANGE_MEAS + 5, 10, 101, 60, MEAS_LABEL_HEIGHT, 0, 0x0, 0 },
  
  { TEXT_CreateIndirect, "=", ID_FIRST_SPEED_RESISTANCE_CHANGE_MEAS + 21, 60, 73, 60, MEAS_LABEL_HEIGHT, 0, 0x0, 0 },
  { TEXT_CreateIndirect, "=", ID_FIRST_SPEED_RESISTANCE_CHANGE_MEAS + 22, 60, 87, 60, MEAS_LABEL_HEIGHT, 0, 0x0, 0 },
  { TEXT_CreateIndirect, "=", ID_FIRST_SPEED_RESISTANCE_CHANGE_MEAS + 23, 60, 101, 60, MEAS_LABEL_HEIGHT, 0, 0x0, 0 },
  
  { TEXT_CreateIndirect, "0", ID_FIRST_SPEED_RESISTANCE_CHANGE_MEAS + 39, 75, 73, 60, MEAS_LABEL_HEIGHT, 0, 0x0, 0 },
  { TEXT_CreateIndirect, "0", ID_FIRST_SPEED_RESISTANCE_CHANGE_MEAS + 40, 75, 87, 60, MEAS_LABEL_HEIGHT, 0, 0x0, 0 },
  { TEXT_CreateIndirect, "0", ID_FIRST_SPEED_RESISTANCE_CHANGE_MEAS + 41, 75, 101, 60, MEAS_LABEL_HEIGHT, 0, 0x0, 0 },
  
  { TEXT_CreateIndirect, "Ступень №3:", ID_MEAS_RES_SPEED_STAGE3_TEXT, 10, 115, 70, MEAS_LABEL_HEIGHT, 0, 0x0, 0 },
  
  { TEXT_CreateIndirect, "Za0", ID_FIRST_SPEED_RESISTANCE_CHANGE_MEAS + 6, 10, 129, 60, MEAS_LABEL_HEIGHT, 0, 0x0, 0 },
  { TEXT_CreateIndirect, "Zb0", ID_FIRST_SPEED_RESISTANCE_CHANGE_MEAS + 7, 10, 143, 60, MEAS_LABEL_HEIGHT, 0, 0x0, 0 },
  { TEXT_CreateIndirect, "Zc0", ID_FIRST_SPEED_RESISTANCE_CHANGE_MEAS + 8, 10, 157, 60, MEAS_LABEL_HEIGHT, 0, 0x0, 0 },
  
  { TEXT_CreateIndirect, "=", ID_FIRST_SPEED_RESISTANCE_CHANGE_MEAS + 24, 60, 129, 60, MEAS_LABEL_HEIGHT, 0, 0x0, 0 },
  { TEXT_CreateIndirect, "=", ID_FIRST_SPEED_RESISTANCE_CHANGE_MEAS + 25, 60, 143, 60, MEAS_LABEL_HEIGHT, 0, 0x0, 0 },
  { TEXT_CreateIndirect, "=", ID_FIRST_SPEED_RESISTANCE_CHANGE_MEAS + 26, 60, 157, 60, MEAS_LABEL_HEIGHT, 0, 0x0, 0 },
  
  { TEXT_CreateIndirect, "0", ID_FIRST_SPEED_RESISTANCE_CHANGE_MEAS + 42, 75, 129, 60, MEAS_LABEL_HEIGHT, 0, 0x0, 0 },
  { TEXT_CreateIndirect, "0", ID_FIRST_SPEED_RESISTANCE_CHANGE_MEAS + 43, 75, 143, 60, MEAS_LABEL_HEIGHT, 0, 0x0, 0 },
  { TEXT_CreateIndirect, "0", ID_FIRST_SPEED_RESISTANCE_CHANGE_MEAS + 44, 75, 157, 60, MEAS_LABEL_HEIGHT, 0, 0x0, 0 },
  
  
  { TEXT_CreateIndirect, "Ступень №4:", ID_MEAS_RES_SPEED_STAGE4_TEXT, 155, 3, 70, MEAS_LABEL_HEIGHT, 0, 0x0, 0 },
  
  { TEXT_CreateIndirect, "Za0", ID_FIRST_SPEED_RESISTANCE_CHANGE_MEAS + 9, 155, 17, 60, MEAS_LABEL_HEIGHT, 0, 0x0, 0 },
  { TEXT_CreateIndirect, "Zb0", ID_FIRST_SPEED_RESISTANCE_CHANGE_MEAS + 10, 155, 31, 60, MEAS_LABEL_HEIGHT, 0, 0x0, 0 },
  { TEXT_CreateIndirect, "Zc0", ID_FIRST_SPEED_RESISTANCE_CHANGE_MEAS + 11, 155, 45, 60, MEAS_LABEL_HEIGHT, 0, 0x0, 0 },
  
  { TEXT_CreateIndirect, "=", ID_FIRST_SPEED_RESISTANCE_CHANGE_MEAS + 27, 185, 17, 60, MEAS_LABEL_HEIGHT, 0, 0x0, 0 },
  { TEXT_CreateIndirect, "=", ID_FIRST_SPEED_RESISTANCE_CHANGE_MEAS + 28, 185, 31, 60, MEAS_LABEL_HEIGHT, 0, 0x0, 0 },
  { TEXT_CreateIndirect, "=", ID_FIRST_SPEED_RESISTANCE_CHANGE_MEAS + 29, 185, 45, 60, MEAS_LABEL_HEIGHT, 0, 0x0, 0 },
  
  { TEXT_CreateIndirect, "0", ID_FIRST_SPEED_RESISTANCE_CHANGE_MEAS + 45, 200, 17, 60, MEAS_LABEL_HEIGHT, 0, 0x0, 0 },
  { TEXT_CreateIndirect, "0", ID_FIRST_SPEED_RESISTANCE_CHANGE_MEAS + 46, 200, 31, 60, MEAS_LABEL_HEIGHT, 0, 0x0, 0 },
  { TEXT_CreateIndirect, "0", ID_FIRST_SPEED_RESISTANCE_CHANGE_MEAS + 47, 200, 45, 60, MEAS_LABEL_HEIGHT, 0, 0x0, 0 },
  
  { TEXT_CreateIndirect, "Ступень №5:", ID_MEAS_RES_SPEED_STAGE5_TEXT, 155, 59, 70, MEAS_LABEL_HEIGHT, 0, 0x0, 0 },
  
  { TEXT_CreateIndirect, "Za0", ID_FIRST_SPEED_RESISTANCE_CHANGE_MEAS + 12, 155, 73, 60, MEAS_LABEL_HEIGHT, 0, 0x0, 0 },
  { TEXT_CreateIndirect, "Zb0", ID_FIRST_SPEED_RESISTANCE_CHANGE_MEAS + 13, 155, 87, 60, MEAS_LABEL_HEIGHT, 0, 0x0, 0 },
  { TEXT_CreateIndirect, "Zc0", ID_FIRST_SPEED_RESISTANCE_CHANGE_MEAS + 14, 155, 101, 60, MEAS_LABEL_HEIGHT, 0, 0x0, 0 },
  
  { TEXT_CreateIndirect, "=", ID_FIRST_SPEED_RESISTANCE_CHANGE_MEAS + 30, 185, 73, 60, MEAS_LABEL_HEIGHT, 0, 0x0, 0 },
  { TEXT_CreateIndirect, "=", ID_FIRST_SPEED_RESISTANCE_CHANGE_MEAS + 31, 185, 87, 60, MEAS_LABEL_HEIGHT, 0, 0x0, 0 },
  { TEXT_CreateIndirect, "=", ID_FIRST_SPEED_RESISTANCE_CHANGE_MEAS + 32, 185, 101, 60, MEAS_LABEL_HEIGHT, 0, 0x0, 0 },
  
  { TEXT_CreateIndirect, "0", ID_FIRST_SPEED_RESISTANCE_CHANGE_MEAS + 48, 200, 73, 60, MEAS_LABEL_HEIGHT, 0, 0x0, 0 },
  { TEXT_CreateIndirect, "0", ID_FIRST_SPEED_RESISTANCE_CHANGE_MEAS + 49, 200, 87, 60, MEAS_LABEL_HEIGHT, 0, 0x0, 0 },
  { TEXT_CreateIndirect, "0", ID_FIRST_SPEED_RESISTANCE_CHANGE_MEAS + 50, 200, 101, 60, MEAS_LABEL_HEIGHT, 0, 0x0, 0 },
  
  { TEXT_CreateIndirect, "Общие:", ID_MEAS_RES_SPEED_COMMON_TEXT, 155, 115, 70, MEAS_LABEL_HEIGHT, 0, 0x0, 0 },
  
  { TEXT_CreateIndirect, "Zab", ID_FIRST_SPEED_RESISTANCE_CHANGE_MEAS + 15, 155, 129, 60, MEAS_LABEL_HEIGHT, 0, 0x0, 0 },
  { TEXT_CreateIndirect, "Zbc", ID_FIRST_SPEED_RESISTANCE_CHANGE_MEAS + 16, 155, 143, 60, MEAS_LABEL_HEIGHT, 0, 0x0, 0 },
  { TEXT_CreateIndirect, "Zca", ID_FIRST_SPEED_RESISTANCE_CHANGE_MEAS + 17, 155, 157, 60, MEAS_LABEL_HEIGHT, 0, 0x0, 0 },
  
  { TEXT_CreateIndirect, "=", ID_FIRST_SPEED_RESISTANCE_CHANGE_MEAS + 33, 185, 129, 60, MEAS_LABEL_HEIGHT, 0, 0x0, 0 },
  { TEXT_CreateIndirect, "=", ID_FIRST_SPEED_RESISTANCE_CHANGE_MEAS + 34, 185, 143, 60, MEAS_LABEL_HEIGHT, 0, 0x0, 0 },
  { TEXT_CreateIndirect, "=", ID_FIRST_SPEED_RESISTANCE_CHANGE_MEAS + 35, 185, 157, 60, MEAS_LABEL_HEIGHT, 0, 0x0, 0 },
  
  { TEXT_CreateIndirect, "0", ID_FIRST_SPEED_RESISTANCE_CHANGE_MEAS + 51, 200, 129, 60, MEAS_LABEL_HEIGHT, 0, 0x0, 0 },
  { TEXT_CreateIndirect, "0", ID_FIRST_SPEED_RESISTANCE_CHANGE_MEAS + 52, 200, 143, 60, MEAS_LABEL_HEIGHT, 0, 0x0, 0 },
  { TEXT_CreateIndirect, "0", ID_LAST_SPEED_RESISTANCE_CHANGE_MEAS, 200, 157, 60, MEAS_LABEL_HEIGHT, 0, 0x0, 0 },
};

static const GUI_WIDGET_CREATE_INFO _aMeasResistAngle[] = {
  { WINDOW_CreateIndirect, "Resistance Angle Dialog", ID_RESISTANCE_ANGLE_PG, MEAS_PG_X, MEAS_PG_Y, MEAS_PG_WIDTH, MEAS_PG_HEIGHT, 0 },
  
  { TEXT_CreateIndirect, "Ступень №1:", ID_MEAS_RES_ANGLE_STAGE1_TEXT, 10, 3, 70, MEAS_LABEL_HEIGHT, 0, 0x0, 0 },
  
  { TEXT_CreateIndirect, "Za0", ID_FIRST_RESISTANCE_ANGLE_MEAS, 10, 17, 60, MEAS_LABEL_HEIGHT, 0, 0x0, 0 },
  { TEXT_CreateIndirect, "Zb0", ID_FIRST_RESISTANCE_ANGLE_MEAS + 1, 10, 31, 60, MEAS_LABEL_HEIGHT, 0, 0x0, 0 },
  { TEXT_CreateIndirect, "Zc0", ID_FIRST_RESISTANCE_ANGLE_MEAS + 2, 10, 45, 60, MEAS_LABEL_HEIGHT, 0, 0x0, 0 },
  
  { TEXT_CreateIndirect, "=", ID_FIRST_RESISTANCE_ANGLE_MEAS + 18, 60, 17, 60, MEAS_LABEL_HEIGHT, 0, 0x0, 0 },
  { TEXT_CreateIndirect, "=", ID_FIRST_RESISTANCE_ANGLE_MEAS + 19, 60, 31, 60, MEAS_LABEL_HEIGHT, 0, 0x0, 0 },
  { TEXT_CreateIndirect, "=", ID_FIRST_RESISTANCE_ANGLE_MEAS + 20, 60, 45, 60, MEAS_LABEL_HEIGHT, 0, 0x0, 0 },
  
  { TEXT_CreateIndirect, "0", ID_FIRST_RESISTANCE_ANGLE_MEAS + 36, 75, 17, 60, MEAS_LABEL_HEIGHT, 0, 0x0, 0 },
  { TEXT_CreateIndirect, "0", ID_FIRST_RESISTANCE_ANGLE_MEAS + 37, 75, 31, 60, MEAS_LABEL_HEIGHT, 0, 0x0, 0 },
  { TEXT_CreateIndirect, "0", ID_FIRST_RESISTANCE_ANGLE_MEAS + 38, 75, 45, 60, MEAS_LABEL_HEIGHT, 0, 0x0, 0 },
  
  { TEXT_CreateIndirect, "Ступень №2:", ID_MEAS_RES_ANGLE_STAGE2_TEXT, 10, 59, 70, MEAS_LABEL_HEIGHT, 0, 0x0, 0 },
  
  { TEXT_CreateIndirect, "Za0", ID_FIRST_RESISTANCE_ANGLE_MEAS + 3, 10, 73, 60, MEAS_LABEL_HEIGHT, 0, 0x0, 0 },
  { TEXT_CreateIndirect, "Zb0", ID_FIRST_RESISTANCE_ANGLE_MEAS + 4, 10, 87, 60, MEAS_LABEL_HEIGHT, 0, 0x0, 0 },
  { TEXT_CreateIndirect, "Zc0", ID_FIRST_RESISTANCE_ANGLE_MEAS + 5, 10, 101, 60, MEAS_LABEL_HEIGHT, 0, 0x0, 0 },
  
  { TEXT_CreateIndirect, "=", ID_FIRST_RESISTANCE_ANGLE_MEAS + 21, 60, 73, 60, MEAS_LABEL_HEIGHT, 0, 0x0, 0 },
  { TEXT_CreateIndirect, "=", ID_FIRST_RESISTANCE_ANGLE_MEAS + 22, 60, 87, 60, MEAS_LABEL_HEIGHT, 0, 0x0, 0 },
  { TEXT_CreateIndirect, "=", ID_FIRST_RESISTANCE_ANGLE_MEAS + 23, 60, 101, 60, MEAS_LABEL_HEIGHT, 0, 0x0, 0 },
  
  { TEXT_CreateIndirect, "0", ID_FIRST_RESISTANCE_ANGLE_MEAS + 39, 75, 73, 60, MEAS_LABEL_HEIGHT, 0, 0x0, 0 },
  { TEXT_CreateIndirect, "0", ID_FIRST_RESISTANCE_ANGLE_MEAS + 40, 75, 87, 60, MEAS_LABEL_HEIGHT, 0, 0x0, 0 },
  { TEXT_CreateIndirect, "0", ID_FIRST_RESISTANCE_ANGLE_MEAS + 41, 75, 101, 60, MEAS_LABEL_HEIGHT, 0, 0x0, 0 },
  
  { TEXT_CreateIndirect, "Ступень №3:", ID_MEAS_RES_ANGLE_STAGE3_TEXT, 10, 115, 70, MEAS_LABEL_HEIGHT, 0, 0x0, 0 },
  
  { TEXT_CreateIndirect, "Za0", ID_FIRST_RESISTANCE_ANGLE_MEAS + 6, 10, 129, 60, MEAS_LABEL_HEIGHT, 0, 0x0, 0 },
  { TEXT_CreateIndirect, "Zb0", ID_FIRST_RESISTANCE_ANGLE_MEAS + 7, 10, 143, 60, MEAS_LABEL_HEIGHT, 0, 0x0, 0 },
  { TEXT_CreateIndirect, "Zc0", ID_FIRST_RESISTANCE_ANGLE_MEAS + 8, 10, 157, 60, MEAS_LABEL_HEIGHT, 0, 0x0, 0 },
  
  { TEXT_CreateIndirect, "=", ID_FIRST_RESISTANCE_ANGLE_MEAS + 24, 60, 129, 60, MEAS_LABEL_HEIGHT, 0, 0x0, 0 },
  { TEXT_CreateIndirect, "=", ID_FIRST_RESISTANCE_ANGLE_MEAS + 25, 60, 143, 60, MEAS_LABEL_HEIGHT, 0, 0x0, 0 },
  { TEXT_CreateIndirect, "=", ID_FIRST_RESISTANCE_ANGLE_MEAS + 26, 60, 157, 60, MEAS_LABEL_HEIGHT, 0, 0x0, 0 },
  
  { TEXT_CreateIndirect, "0", ID_FIRST_RESISTANCE_ANGLE_MEAS + 42, 75, 129, 60, MEAS_LABEL_HEIGHT, 0, 0x0, 0 },
  { TEXT_CreateIndirect, "0", ID_FIRST_RESISTANCE_ANGLE_MEAS + 43, 75, 143, 60, MEAS_LABEL_HEIGHT, 0, 0x0, 0 },
  { TEXT_CreateIndirect, "0", ID_FIRST_RESISTANCE_ANGLE_MEAS + 44, 75, 157, 60, MEAS_LABEL_HEIGHT, 0, 0x0, 0 },
  
  
  { TEXT_CreateIndirect, "Ступень №4:", ID_MEAS_RES_ANGLE_STAGE4_TEXT, 155, 3, 70, MEAS_LABEL_HEIGHT, 0, 0x0, 0 },
  
  { TEXT_CreateIndirect, "Za0", ID_FIRST_RESISTANCE_ANGLE_MEAS + 9, 155, 17, 60, MEAS_LABEL_HEIGHT, 0, 0x0, 0 },
  { TEXT_CreateIndirect, "Zb0", ID_FIRST_RESISTANCE_ANGLE_MEAS + 10, 155, 31, 60, MEAS_LABEL_HEIGHT, 0, 0x0, 0 },
  { TEXT_CreateIndirect, "Zc0", ID_FIRST_RESISTANCE_ANGLE_MEAS + 11, 155, 45, 60, MEAS_LABEL_HEIGHT, 0, 0x0, 0 },
  
  { TEXT_CreateIndirect, "=", ID_FIRST_RESISTANCE_ANGLE_MEAS + 27, 185, 17, 60, MEAS_LABEL_HEIGHT, 0, 0x0, 0 },
  { TEXT_CreateIndirect, "=", ID_FIRST_RESISTANCE_ANGLE_MEAS + 28, 185, 31, 60, MEAS_LABEL_HEIGHT, 0, 0x0, 0 },
  { TEXT_CreateIndirect, "=", ID_FIRST_RESISTANCE_ANGLE_MEAS + 29, 185, 45, 60, MEAS_LABEL_HEIGHT, 0, 0x0, 0 },
  
  { TEXT_CreateIndirect, "0", ID_FIRST_RESISTANCE_ANGLE_MEAS + 45, 200, 17, 60, MEAS_LABEL_HEIGHT, 0, 0x0, 0 },
  { TEXT_CreateIndirect, "0", ID_FIRST_RESISTANCE_ANGLE_MEAS + 46, 200, 31, 60, MEAS_LABEL_HEIGHT, 0, 0x0, 0 },
  { TEXT_CreateIndirect, "0", ID_FIRST_RESISTANCE_ANGLE_MEAS + 47, 200, 45, 60, MEAS_LABEL_HEIGHT, 0, 0x0, 0 },
  
  { TEXT_CreateIndirect, "Ступень №5:", ID_MEAS_RES_ANGLE_STAGE5_TEXT, 155, 59, 70, MEAS_LABEL_HEIGHT, 0, 0x0, 0 },
  
  { TEXT_CreateIndirect, "Za0", ID_FIRST_RESISTANCE_ANGLE_MEAS + 12, 155, 73, 60, MEAS_LABEL_HEIGHT, 0, 0x0, 0 },
  { TEXT_CreateIndirect, "Zb0", ID_FIRST_RESISTANCE_ANGLE_MEAS + 13, 155, 87, 60, MEAS_LABEL_HEIGHT, 0, 0x0, 0 },
  { TEXT_CreateIndirect, "Zc0", ID_FIRST_RESISTANCE_ANGLE_MEAS + 14, 155, 101, 60, MEAS_LABEL_HEIGHT, 0, 0x0, 0 },
  
  { TEXT_CreateIndirect, "=", ID_FIRST_RESISTANCE_ANGLE_MEAS + 30, 185, 73, 60, MEAS_LABEL_HEIGHT, 0, 0x0, 0 },
  { TEXT_CreateIndirect, "=", ID_FIRST_RESISTANCE_ANGLE_MEAS + 31, 185, 87, 60, MEAS_LABEL_HEIGHT, 0, 0x0, 0 },
  { TEXT_CreateIndirect, "=", ID_FIRST_RESISTANCE_ANGLE_MEAS + 32, 185, 101, 60, MEAS_LABEL_HEIGHT, 0, 0x0, 0 },
  
  { TEXT_CreateIndirect, "0", ID_FIRST_RESISTANCE_ANGLE_MEAS + 48, 200, 73, 60, MEAS_LABEL_HEIGHT, 0, 0x0, 0 },
  { TEXT_CreateIndirect, "0", ID_FIRST_RESISTANCE_ANGLE_MEAS + 49, 200, 87, 60, MEAS_LABEL_HEIGHT, 0, 0x0, 0 },
  { TEXT_CreateIndirect, "0", ID_FIRST_RESISTANCE_ANGLE_MEAS + 50, 200, 101, 60, MEAS_LABEL_HEIGHT, 0, 0x0, 0 },
  
  { TEXT_CreateIndirect, "Общие:", ID_MEAS_RES_ANGLE_COMMON_TEXT, 155, 115, 70, MEAS_LABEL_HEIGHT, 0, 0x0, 0 },
  
  { TEXT_CreateIndirect, "Zab", ID_FIRST_RESISTANCE_ANGLE_MEAS + 15, 155, 129, 60, MEAS_LABEL_HEIGHT, 0, 0x0, 0 },
  { TEXT_CreateIndirect, "Zbc", ID_FIRST_RESISTANCE_ANGLE_MEAS + 16, 155, 143, 60, MEAS_LABEL_HEIGHT, 0, 0x0, 0 },
  { TEXT_CreateIndirect, "Zca", ID_FIRST_RESISTANCE_ANGLE_MEAS + 17, 155, 157, 60, MEAS_LABEL_HEIGHT, 0, 0x0, 0 },
  
  { TEXT_CreateIndirect, "=", ID_FIRST_RESISTANCE_ANGLE_MEAS + 33, 185, 129, 60, MEAS_LABEL_HEIGHT, 0, 0x0, 0 },
  { TEXT_CreateIndirect, "=", ID_FIRST_RESISTANCE_ANGLE_MEAS + 34, 185, 143, 60, MEAS_LABEL_HEIGHT, 0, 0x0, 0 },
  { TEXT_CreateIndirect, "=", ID_FIRST_RESISTANCE_ANGLE_MEAS + 35, 185, 157, 60, MEAS_LABEL_HEIGHT, 0, 0x0, 0 },
  
  { TEXT_CreateIndirect, "0", ID_FIRST_RESISTANCE_ANGLE_MEAS + 51, 200, 129, 60, MEAS_LABEL_HEIGHT, 0, 0x0, 0 },
  { TEXT_CreateIndirect, "0", ID_FIRST_RESISTANCE_ANGLE_MEAS + 52, 200, 143, 60, MEAS_LABEL_HEIGHT, 0, 0x0, 0 },
  { TEXT_CreateIndirect, "0", ID_LAST_RESISTANCE_ANGLE_MEAS, 200, 157, 60, MEAS_LABEL_HEIGHT, 0, 0x0, 0 },
};

static const GUI_WIDGET_CREATE_INFO _aMeasPgCreate7[] = {
  { WINDOW_CreateIndirect, "Dialog 7", ID_MEAS_PG_5, MEAS_PG_X, MEAS_PG_Y, MEAS_PG_WIDTH, MEAS_PG_HEIGHT, 0 },
  
  { TEXT_CreateIndirect, "F1", ID_FIRST_OTHER_MEAS,                  10, 5,   80, MEAS_LABEL_HEIGHT, 0, 0x0, 0 },
  { TEXT_CreateIndirect, "F2", ID_FIRST_OTHER_MEAS + 1,              10, 20,  80, MEAS_LABEL_HEIGHT, 0, 0x0, 0 },
  { TEXT_CreateIndirect, "Speed Ang.", ID_FIRST_OTHER_MEAS + 2,      10, 35,  80, MEAS_LABEL_HEIGHT, 0, 0x0, 0 },
  { TEXT_CreateIndirect, "Lin. Iab", ID_FIRST_OTHER_MEAS + 3,        10, 50,  80, MEAS_LABEL_HEIGHT, 0, 0x0, 0 },
  { TEXT_CreateIndirect, "Lin. Ibc", ID_FIRST_OTHER_MEAS + 4,        10, 65,  80, MEAS_LABEL_HEIGHT, 0, 0x0, 0 },
  { TEXT_CreateIndirect, "Lin. Ica", ID_FIRST_OTHER_MEAS + 5,        10, 80,  80, MEAS_LABEL_HEIGHT, 0, 0x0, 0 },
  { TEXT_CreateIndirect, "Lin. Uab", ID_FIRST_OTHER_MEAS + 6,        10, 95,  80, MEAS_LABEL_HEIGHT, 0, 0x0, 0 },
  { TEXT_CreateIndirect, "Lin. Ubc", ID_FIRST_OTHER_MEAS + 7,        10, 110, 80, MEAS_LABEL_HEIGHT, 0, 0x0, 0 },
  { TEXT_CreateIndirect, "Lin. Uca", ID_FIRST_OTHER_MEAS + 8,        10, 125, 80, MEAS_LABEL_HEIGHT, 0, 0x0, 0 },
  { TEXT_CreateIndirect, "U diff", ID_FIRST_OTHER_MEAS + 9,          10, 140, 80, MEAS_LABEL_HEIGHT, 0, 0x0, 0 },
  { TEXT_CreateIndirect, "U line", ID_FIRST_OTHER_MEAS + 10,         10, 155, 80, MEAS_LABEL_HEIGHT, 0, 0x0, 0 },
  { TEXT_CreateIndirect, "Act.Pow.A", ID_FIRST_OTHER_MEAS + 11,      10, 170, 80, MEAS_LABEL_HEIGHT, 0, 0x0, 0 },
  { TEXT_CreateIndirect, "Act.Pow.B", ID_FIRST_OTHER_MEAS + 12,      10, 185, 80, MEAS_LABEL_HEIGHT, 0, 0x0, 0 },
  { TEXT_CreateIndirect, "Act.Pow.C", ID_FIRST_OTHER_MEAS + 13,      10, 200, 80, MEAS_LABEL_HEIGHT, 0, 0x0, 0 },
  { TEXT_CreateIndirect, "React.Pow.A", ID_FIRST_OTHER_MEAS + 14,    10, 215, 80, MEAS_LABEL_HEIGHT, 0, 0x0, 0 },
  { TEXT_CreateIndirect, "React.Pow.B", ID_FIRST_OTHER_MEAS + 15,    10, 230, 80, MEAS_LABEL_HEIGHT, 0, 0x0, 0 },
  { TEXT_CreateIndirect, "React.Pow.C", ID_FIRST_OTHER_MEAS + 16,    10, 245, 80, MEAS_LABEL_HEIGHT, 0, 0x0, 0 },
  { TEXT_CreateIndirect, "Full Pow.A", ID_FIRST_OTHER_MEAS + 17,     10, 260, 80, MEAS_LABEL_HEIGHT, 0, 0x0, 0 },
  { TEXT_CreateIndirect, "Full Pow.B", ID_FIRST_OTHER_MEAS + 18,     10, 275, 80, MEAS_LABEL_HEIGHT, 0, 0x0, 0 },
  { TEXT_CreateIndirect, "Full Pow.С", ID_FIRST_OTHER_MEAS + 19,     10, 290, 80, MEAS_LABEL_HEIGHT, 0, 0x0, 0 },
  { TEXT_CreateIndirect, "Sum.Act.Pow.", ID_FIRST_OTHER_MEAS + 20,   10, 305, 80, MEAS_LABEL_HEIGHT, 0, 0x0, 0 },
  { TEXT_CreateIndirect, "Sum.React.Pow.", ID_FIRST_OTHER_MEAS + 21, 10, 320, 80, MEAS_LABEL_HEIGHT, 0, 0x0, 0 },
  { TEXT_CreateIndirect, "Sum.Full.Pow", ID_FIRST_OTHER_MEAS + 22,   10, 335, 80, MEAS_LABEL_HEIGHT, 0, 0x0, 0 },
  { TEXT_CreateIndirect, "Koeff.Pow.A", ID_FIRST_OTHER_MEAS + 23,    10, 350, 80, MEAS_LABEL_HEIGHT, 0, 0x0, 0 },
  { TEXT_CreateIndirect, "Koeff.Pow.B", ID_FIRST_OTHER_MEAS + 24,    10, 365, 80, MEAS_LABEL_HEIGHT, 0, 0x0, 0 },
  { TEXT_CreateIndirect, "Koeff.Pow.C", ID_FIRST_OTHER_MEAS + 25,    10, 380, 80, MEAS_LABEL_HEIGHT, 0, 0x0, 0 },
  { TEXT_CreateIndirect, "Act.Pow. +", ID_FIRST_OTHER_MEAS + 26,     10, 395, 80, MEAS_LABEL_HEIGHT, 0, 0x0, 0 },
  { TEXT_CreateIndirect, "Act.Pow. -", ID_FIRST_OTHER_MEAS + 27,     10, 410, 80, MEAS_LABEL_HEIGHT, 0, 0x0, 0 },
  { TEXT_CreateIndirect, "React.Pow.q1", ID_FIRST_OTHER_MEAS + 28,   10, 425, 80, MEAS_LABEL_HEIGHT, 0, 0x0, 0 },
  { TEXT_CreateIndirect, "React.Pow.q2", ID_FIRST_OTHER_MEAS + 29,   10, 440, 80, MEAS_LABEL_HEIGHT, 0, 0x0, 0 },
  { TEXT_CreateIndirect, "React.Pow.q3", ID_FIRST_OTHER_MEAS + 30,   10, 455, 80, MEAS_LABEL_HEIGHT, 0, 0x0, 0 },
  { TEXT_CreateIndirect, "React.Pow.q4", ID_FIRST_OTHER_MEAS + 31,   10, 470, 80, MEAS_LABEL_HEIGHT, 0, 0x0, 0 },
  
  { TEXT_CreateIndirect, "=", ID_FIRST_OTHER_MEAS + 32, 110, 5,   10, MEAS_LABEL_HEIGHT, 0, 0x0, 0 },
  { TEXT_CreateIndirect, "=", ID_FIRST_OTHER_MEAS + 33, 110, 20,  10, MEAS_LABEL_HEIGHT, 0, 0x0, 0 },
  { TEXT_CreateIndirect, "=", ID_FIRST_OTHER_MEAS + 34, 110, 35,  10, MEAS_LABEL_HEIGHT, 0, 0x0, 0 },
  { TEXT_CreateIndirect, "=", ID_FIRST_OTHER_MEAS + 35, 110, 50,  10, MEAS_LABEL_HEIGHT, 0, 0x0, 0 },
  { TEXT_CreateIndirect, "=", ID_FIRST_OTHER_MEAS + 36, 110, 65,  10, MEAS_LABEL_HEIGHT, 0, 0x0, 0 },
  { TEXT_CreateIndirect, "=", ID_FIRST_OTHER_MEAS + 37, 110, 80,  10, MEAS_LABEL_HEIGHT, 0, 0x0, 0 },
  { TEXT_CreateIndirect, "=", ID_FIRST_OTHER_MEAS + 38, 110, 95,  10, MEAS_LABEL_HEIGHT, 0, 0x0, 0 },
  { TEXT_CreateIndirect, "=", ID_FIRST_OTHER_MEAS + 39, 110, 110, 10, MEAS_LABEL_HEIGHT, 0, 0x0, 0 },
  { TEXT_CreateIndirect, "=", ID_FIRST_OTHER_MEAS + 40, 110, 125, 10, MEAS_LABEL_HEIGHT, 0, 0x0, 0 },
  { TEXT_CreateIndirect, "=", ID_FIRST_OTHER_MEAS + 41, 110, 140, 10, MEAS_LABEL_HEIGHT, 0, 0x0, 0 },
  { TEXT_CreateIndirect, "=", ID_FIRST_OTHER_MEAS + 42, 110, 155, 10, MEAS_LABEL_HEIGHT, 0, 0x0, 0 },
  { TEXT_CreateIndirect, "=", ID_FIRST_OTHER_MEAS + 43, 110, 170, 10, MEAS_LABEL_HEIGHT, 0, 0x0, 0 },
  { TEXT_CreateIndirect, "=", ID_FIRST_OTHER_MEAS + 44, 110, 185, 10, MEAS_LABEL_HEIGHT, 0, 0x0, 0 },
  { TEXT_CreateIndirect, "=", ID_FIRST_OTHER_MEAS + 45, 110, 200, 10, MEAS_LABEL_HEIGHT, 0, 0x0, 0 },
  { TEXT_CreateIndirect, "=", ID_FIRST_OTHER_MEAS + 46, 110, 215, 10, MEAS_LABEL_HEIGHT, 0, 0x0, 0 },
  { TEXT_CreateIndirect, "=", ID_FIRST_OTHER_MEAS + 47, 110, 230, 10, MEAS_LABEL_HEIGHT, 0, 0x0, 0 },
  { TEXT_CreateIndirect, "=", ID_FIRST_OTHER_MEAS + 48, 110, 245, 10, MEAS_LABEL_HEIGHT, 0, 0x0, 0 },
  { TEXT_CreateIndirect, "=", ID_FIRST_OTHER_MEAS + 49, 110, 260, 10, MEAS_LABEL_HEIGHT, 0, 0x0, 0 },
  { TEXT_CreateIndirect, "=", ID_FIRST_OTHER_MEAS + 50, 110, 275, 10, MEAS_LABEL_HEIGHT, 0, 0x0, 0 },
  { TEXT_CreateIndirect, "=", ID_FIRST_OTHER_MEAS + 51, 110, 290, 10, MEAS_LABEL_HEIGHT, 0, 0x0, 0 },
  { TEXT_CreateIndirect, "=", ID_FIRST_OTHER_MEAS + 52, 110, 305, 10, MEAS_LABEL_HEIGHT, 0, 0x0, 0 },
  { TEXT_CreateIndirect, "=", ID_FIRST_OTHER_MEAS + 53, 110, 320, 10, MEAS_LABEL_HEIGHT, 0, 0x0, 0 },
  { TEXT_CreateIndirect, "=", ID_FIRST_OTHER_MEAS + 54, 110, 335, 10, MEAS_LABEL_HEIGHT, 0, 0x0, 0 },
  { TEXT_CreateIndirect, "=", ID_FIRST_OTHER_MEAS + 55, 110, 350, 10, MEAS_LABEL_HEIGHT, 0, 0x0, 0 },
  { TEXT_CreateIndirect, "=", ID_FIRST_OTHER_MEAS + 56, 110, 365, 10, MEAS_LABEL_HEIGHT, 0, 0x0, 0 },
  { TEXT_CreateIndirect, "=", ID_FIRST_OTHER_MEAS + 57, 110, 380, 10, MEAS_LABEL_HEIGHT, 0, 0x0, 0 },
  { TEXT_CreateIndirect, "=", ID_FIRST_OTHER_MEAS + 58, 110, 395, 10, MEAS_LABEL_HEIGHT, 0, 0x0, 0 },
  { TEXT_CreateIndirect, "=", ID_FIRST_OTHER_MEAS + 59, 110, 410, 10, MEAS_LABEL_HEIGHT, 0, 0x0, 0 },
  { TEXT_CreateIndirect, "=", ID_FIRST_OTHER_MEAS + 60, 110, 425, 10, MEAS_LABEL_HEIGHT, 0, 0x0, 0 },
  { TEXT_CreateIndirect, "=", ID_FIRST_OTHER_MEAS + 61, 110, 440, 10, MEAS_LABEL_HEIGHT, 0, 0x0, 0 },
  { TEXT_CreateIndirect, "=", ID_FIRST_OTHER_MEAS + 62, 110, 455, 10, MEAS_LABEL_HEIGHT, 0, 0x0, 0 },
  { TEXT_CreateIndirect, "=", ID_FIRST_OTHER_MEAS + 63, 110, 470, 10, MEAS_LABEL_HEIGHT, 0, 0x0, 0 },
  
  { TEXT_CreateIndirect, "0", ID_FIRST_OTHER_MEAS + 64, 125, 5,   50, MEAS_LABEL_HEIGHT, 0, 0x0, 0 },
  { TEXT_CreateIndirect, "0", ID_FIRST_OTHER_MEAS + 65, 125, 20,  50, MEAS_LABEL_HEIGHT, 0, 0x0, 0 },
  { TEXT_CreateIndirect, "0", ID_FIRST_OTHER_MEAS + 66, 125, 35,  50, MEAS_LABEL_HEIGHT, 0, 0x0, 0 },
  { TEXT_CreateIndirect, "0", ID_FIRST_OTHER_MEAS + 67, 125, 50,  50, MEAS_LABEL_HEIGHT, 0, 0x0, 0 },
  { TEXT_CreateIndirect, "0", ID_FIRST_OTHER_MEAS + 68, 125, 65,  50, MEAS_LABEL_HEIGHT, 0, 0x0, 0 },
  { TEXT_CreateIndirect, "0", ID_FIRST_OTHER_MEAS + 69, 125, 80,  50, MEAS_LABEL_HEIGHT, 0, 0x0, 0 },
  { TEXT_CreateIndirect, "0", ID_FIRST_OTHER_MEAS + 70, 125, 95,  50, MEAS_LABEL_HEIGHT, 0, 0x0, 0 },
  { TEXT_CreateIndirect, "0", ID_FIRST_OTHER_MEAS + 71, 125, 110, 50, MEAS_LABEL_HEIGHT, 0, 0x0, 0 },
  { TEXT_CreateIndirect, "0", ID_FIRST_OTHER_MEAS + 72, 125, 125, 50, MEAS_LABEL_HEIGHT, 0, 0x0, 0 },
  { TEXT_CreateIndirect, "0", ID_FIRST_OTHER_MEAS + 73, 125, 140, 50, MEAS_LABEL_HEIGHT, 0, 0x0, 0 },
  { TEXT_CreateIndirect, "0", ID_FIRST_OTHER_MEAS + 74, 125, 155, 50, MEAS_LABEL_HEIGHT, 0, 0x0, 0 },
  { TEXT_CreateIndirect, "0", ID_FIRST_OTHER_MEAS + 75, 125, 170, 50, MEAS_LABEL_HEIGHT, 0, 0x0, 0 },
  { TEXT_CreateIndirect, "0", ID_FIRST_OTHER_MEAS + 76, 125, 185, 50, MEAS_LABEL_HEIGHT, 0, 0x0, 0 },
  { TEXT_CreateIndirect, "0", ID_FIRST_OTHER_MEAS + 77, 125, 200, 50, MEAS_LABEL_HEIGHT, 0, 0x0, 0 },
  { TEXT_CreateIndirect, "0", ID_FIRST_OTHER_MEAS + 78, 125, 215, 50, MEAS_LABEL_HEIGHT, 0, 0x0, 0 },
  { TEXT_CreateIndirect, "0", ID_FIRST_OTHER_MEAS + 79, 125, 230, 50, MEAS_LABEL_HEIGHT, 0, 0x0, 0 },
  { TEXT_CreateIndirect, "0", ID_FIRST_OTHER_MEAS + 80, 125, 245, 50, MEAS_LABEL_HEIGHT, 0, 0x0, 0 },
  { TEXT_CreateIndirect, "0", ID_FIRST_OTHER_MEAS + 81, 125, 260, 50, MEAS_LABEL_HEIGHT, 0, 0x0, 0 },
  { TEXT_CreateIndirect, "0", ID_FIRST_OTHER_MEAS + 82, 125, 275, 50, MEAS_LABEL_HEIGHT, 0, 0x0, 0 },
  { TEXT_CreateIndirect, "0", ID_FIRST_OTHER_MEAS + 83, 125, 290, 50, MEAS_LABEL_HEIGHT, 0, 0x0, 0 },
  { TEXT_CreateIndirect, "0", ID_FIRST_OTHER_MEAS + 84, 125, 305, 50, MEAS_LABEL_HEIGHT, 0, 0x0, 0 },
  { TEXT_CreateIndirect, "0", ID_FIRST_OTHER_MEAS + 85, 125, 320, 50, MEAS_LABEL_HEIGHT, 0, 0x0, 0 },
  { TEXT_CreateIndirect, "0", ID_FIRST_OTHER_MEAS + 86, 125, 335, 50, MEAS_LABEL_HEIGHT, 0, 0x0, 0 },
  { TEXT_CreateIndirect, "0", ID_FIRST_OTHER_MEAS + 87, 125, 350, 50, MEAS_LABEL_HEIGHT, 0, 0x0, 0 },
  { TEXT_CreateIndirect, "0", ID_FIRST_OTHER_MEAS + 88, 125, 365, 50, MEAS_LABEL_HEIGHT, 0, 0x0, 0 },
  { TEXT_CreateIndirect, "0", ID_FIRST_OTHER_MEAS + 89, 125, 380, 50, MEAS_LABEL_HEIGHT, 0, 0x0, 0 },
  { TEXT_CreateIndirect, "0", ID_FIRST_OTHER_MEAS + 90, 125, 395, 50, MEAS_LABEL_HEIGHT, 0, 0x0, 0 },
  { TEXT_CreateIndirect, "0", ID_FIRST_OTHER_MEAS + 91, 125, 410, 50, MEAS_LABEL_HEIGHT, 0, 0x0, 0 },
  { TEXT_CreateIndirect, "0", ID_FIRST_OTHER_MEAS + 92, 125, 425, 50, MEAS_LABEL_HEIGHT, 0, 0x0, 0 },
  { TEXT_CreateIndirect, "0", ID_FIRST_OTHER_MEAS + 93, 125, 440, 50, MEAS_LABEL_HEIGHT, 0, 0x0, 0 },
  { TEXT_CreateIndirect, "0", ID_FIRST_OTHER_MEAS + 94, 125, 455, 50, MEAS_LABEL_HEIGHT, 0, 0x0, 0 },
  { TEXT_CreateIndirect, "0", ID_LAST_OTHER_MEAS,       125, 470, 50, MEAS_LABEL_HEIGHT, 0, 0x0, 0 },
};

/*********************************************************************
*
*       _cbDialog1
*/
static void _cbDialog1(WM_MESSAGE * pMsg) {
  switch (pMsg->MsgId) {
  default:
    WM_DefaultProc(pMsg);
  }
}

/*********************************************************************
*
*       _cbDialog2
*/
static void _cbDialog2(WM_MESSAGE * pMsg) {
  switch (pMsg->MsgId) {
  default:
    WM_DefaultProc(pMsg);
  }
}

/*********************************************************************
*
*       _cbDialog3
*/
static void _cbDialog3(WM_MESSAGE * pMsg) {
  switch (pMsg->MsgId) {
  default:
    WM_DefaultProc(pMsg);
  }
}

/*********************************************************************
*
*       _cbCommonResistancesDialog
*/
static void _cbCommonResistancesDialog(WM_MESSAGE * pMsg) {
  switch (pMsg->MsgId) {
  default:
    WM_DefaultProc(pMsg);
  }
}

/*********************************************************************
*
*       _cbDialog4
*/
static void _cbDialog4(WM_MESSAGE * pMsg) {
  switch (pMsg->MsgId) {
  default:
    WM_DefaultProc(pMsg);
  }
}

/*********************************************************************
*
*       _cbDialog5
*/
static void _cbDialog5(WM_MESSAGE * pMsg) {
  switch (pMsg->MsgId) {
  default:
    WM_DefaultProc(pMsg);
  }
}

/*********************************************************************
*
*       _cbResistanceAngle
*/
static void _cbResistanceAngle(WM_MESSAGE * pMsg) {
  switch (pMsg->MsgId) {
  default:
    WM_DefaultProc(pMsg);
  }
}

/*********************************************************************
*
*       _cbDialog6
*/
static void _cbDialog6(WM_MESSAGE * pMsg) {
  switch (pMsg->MsgId) {
  default:
    WM_DefaultProc(pMsg);
  }
}

/*********************************************************************
*
*       _cbMeasWin
*/
static void _cbMeasWin(WM_MESSAGE * pMsg) {
//  WM_HWIN hItem;
  int     NCode;
  int     Id;
  // USER START (Optionally insert additional variables)
  // USER END
  switch (pMsg->MsgId) {
  case WM_INIT_DIALOG:
    //
    // Initialization of 'Framewin'
    //
    // USER START (Optionally insert additional code for further widget initialization)
    // USER END
    break;
  case WM_NOTIFY_PARENT:
    Id    = WM_GetId(pMsg->hWinSrc);
    NCode = pMsg->Data.v;
    switch(Id) {
    case (GUI_ID_USER + 3): // Notifications sent by 'Multipage'
      switch(NCode) {
      case WM_NOTIFICATION_CLICKED:
        // USER START (Optionally insert code for reacting on notification message)
        // USER END
        Id    = WM_GetId(pMsg->hWinSrc);
        break;
      case WM_NOTIFICATION_RELEASED:
        // USER START (Optionally insert code for reacting on notification message)
        // USER END
        Id    = WM_GetId(pMsg->hWinSrc);
        break;
      case WM_NOTIFICATION_MOVED_OUT:
        // USER START (Optionally insert code for reacting on notification message)
        // USER END
        Id    = WM_GetId(pMsg->hWinSrc);
        break;
      case WM_NOTIFICATION_VALUE_CHANGED:
        // USER START (Optionally insert code for reacting on notification message)
        // USER END
        Id    = WM_GetId(pMsg->hWinSrc);
        break;
      // USER START (Optionally insert additional code for further notification handling)
      // USER END
      }
      break;
    // USER START (Optionally insert additional code for further Ids)
    // USER END
    }
    break;
  // USER START (Optionally insert additional message handling)
  // USER END
  case WM_PAINT:
  default:
    WM_DefaultProc(pMsg);
    break;
  }
}

void update_measurement_pg() {
  #define _TEXT_MEAS_LENGTH_    17 //signe + max val + point + precision + unit
  
  #define MEAS_CONST_ARR {      \
    INDEX_3I0,                  \
    INDEX_IA,                   \
    INDEX_IB,                   \
    INDEX_IC,                   \
    INDEX_3U0,                  \
    INDEX_UA,                   \
    INDEX_UB,                   \
    INDEX_UC,                   \
    INDEX_ISYN,                 \
    INDEX_USYN,                 \
    INDEX_UBC_TN2,              \
    INDEX_I2,                   \
    INDEX_U2,                   \
    INDEX_I1,                   \
    INDEX_U1,                   \
    INDEX_I0                    \
  };
  #define PRECISIONS { 4,3,3,3,3,3,3,3,4,3,3,3,3,3,3,3 }

  GetTotMeas(&gui_total_measurement);
  __TOTAL_MEASUREMENT* current_meas_p = &gui_total_measurement;
  
  int cnt = 0;
  char text[_TEXT_MEAS_LENGTH_] = {0};
  int meas_const_arr[NUMBER_FOURIER_MEAS] = MEAS_CONST_ARR;
  int precisions[NUMBER_FOURIER_MEAS] = PRECISIONS;
  for (int id = ID_FIRST_FOURIER_MEAS + 2 * NUMBER_FOURIER_MEAS; id <= ID_LAST_FOURIER_MEAS; id++) {
    for (int j = 0; j < _TEXT_MEAS_LENGTH_; j++) {
      text[j] = 0;
    }
    _PARSE_INT_TO_DOUBLE_STR(current_meas_p -> measurement[meas_const_arr[cnt]], precisions[cnt], text);
    _CONCAT_STR(text, meas_item_units[ID_MEAS_FOURIER_PG][sel_language][cnt]);
    TEXT_SetText(WM_GetDialogItem(measMultiPageWin, id), text);
    
    cnt++;
  }
  
  #undef _TEXT_MEAS_LENGTH
  #undef MEAS_CONST_ARR
  #undef PRECISIONS
}

void update_measurement_i_pg() {
  #define _TEXT_MEAS_I_LENGTH_          17 //signe + max val + point + precision + unit
  
  #define MEAS_I_CONST_ARR {    \
    INDEX_3I0,                  \
    INDEX_IA,                   \
    INDEX_IB,                   \
    INDEX_IC,                   \
    INDEX_3U0,                  \
    INDEX_UA,                   \
    INDEX_UB,                   \
    INDEX_UC,                   \
    INDEX_ISYN,                 \
    INDEX_USYN,                 \
    INDEX_UBC_TN2               \
  };
  #define PRECISIONS { 4,3,3,3,3,3,3,3,4,3,3 }

  GetTotMeas(&gui_total_measurement);
  __TOTAL_MEASUREMENT* current_meas_p = &gui_total_measurement;
  
  int cnt = 0;
  char text[_TEXT_MEAS_I_LENGTH_] = {0};
  int meas_i_const_arr[NUMBER_SUM_EQUATION_MEAS] = MEAS_I_CONST_ARR;
  int precisions[NUMBER_SUM_EQUATION_MEAS] = PRECISIONS;
  for (int id = ID_FIRST_SUM_EQUATION_MEAS + 2 * NUMBER_SUM_EQUATION_MEAS; id <= ID_LAST_SUM_EQUATION_MEAS; id++) {
    for (int j = 0; j < _TEXT_MEAS_I_LENGTH_; j++) {
      text[j] = 0;
    }
    _PARSE_INT_TO_DOUBLE_STR(current_meas_p -> measurement_i[meas_i_const_arr[cnt]], precisions[cnt], text);
    _CONCAT_STR(text, meas_item_units[ID_MEAS_SUM_EQUATION_PG][sel_language][cnt]);
    TEXT_SetText(WM_GetDialogItem(measMultiPageWin, id), text);
    
    cnt++;
  }
  
  #undef _TEXT_MEAS_I_LENGTH_
  #undef MEAS_I_CONST_ARR
  #undef PRECISIONS
}

void update_angles_pg() {
  #define _TEXT_ANGLE_LENGTH_           13 //signe + max val + unit
  
  GetTotMeas(&gui_total_measurement);
  __TOTAL_MEASUREMENT* current_meas_p = &gui_total_measurement;
  
  int angles_arr[NUMBER_ANGLES_MEAS] = {
    current_meas_p -> angle_IA_UBC,
    current_meas_p -> angle_IB_UCA,
    current_meas_p -> angle_IC_UAB,
    current_meas_p -> angle_I2_U2,
    current_meas_p -> angle_3I0_3U0,
    current_meas_p -> angle_unbalance,
    current_meas_p -> angle[0],
    current_meas_p -> angle[1],
    current_meas_p -> angle[2],
    current_meas_p -> angle[3],
    current_meas_p -> angle[4],
    current_meas_p -> angle[5],
    current_meas_p -> angle[6],
    current_meas_p -> angle[6],
    current_meas_p -> angle[8],
    current_meas_p -> angle[9]
  };
  
  int cnt = 0;
  char text[_TEXT_ANGLE_LENGTH_] = {0};
  for (int id = ID_FIRST_ANGLES_MEAS + 2 * NUMBER_ANGLES_MEAS; id <= ID_LAST_ANGLES_MEAS; id++) {
    for (int j = 0; j < _TEXT_ANGLE_LENGTH_; j++) {
      text[j] = 0;
    }
    _PARSE_INT_TO_STR(angles_arr[cnt], text);
    _CONCAT_STR(text, meas_item_units[ID_MEAS_ANGLES_PG][sel_language][cnt]);
    TEXT_SetText(WM_GetDialogItem(measMultiPageWin, id), text);
    
    cnt++;
  }
  
  #undef _TEXT_ANGLE_LENGTH_
}

void update_resistances_pg() {
  #define _TEXT_RESISTANCES_LENGTH_     17 //signe + max val + point + precision + unit
  
  GetTotMeas(&gui_total_measurement);
  __TOTAL_MEASUREMENT* current_meas_p = &gui_total_measurement;
  
  int first_resistances_id, last_resistances_id, number_resistances;
  int resistances_arr[NUMBER_RESISTANCES_MEAS];
  
  if (resistancesPosition < MEAS_NUM_LEVEL_RESISTANCES - 1) {
    first_resistances_id = ID_FIRST_RESISTANCES_MEAS;
    last_resistances_id = ID_LAST_RESISTANCES_MEAS;
    number_resistances = NUMBER_RESISTANCES_MEAS;
    resistances_arr[0] = (int) ceil((current_meas_p -> resistance_f[0 + resistancesPosition * 2]) * 1000);
    resistances_arr[1] = (int) ceil((current_meas_p -> resistance_f[1 + resistancesPosition * 2]) * 1000);
    resistances_arr[2] = (int) ceil((current_meas_p -> resistance_f[10 + resistancesPosition * 2]) * 1000);
    resistances_arr[3] = (int) ceil((current_meas_p -> resistance_f[11 + resistancesPosition * 2]) * 1000);
    resistances_arr[4] = (int) ceil((current_meas_p -> resistance_f[20 + resistancesPosition * 2]) * 1000);
    resistances_arr[5] = (int) ceil((current_meas_p -> resistance_f[21 + resistancesPosition * 2]) * 1000);
    resistances_arr[6] = current_meas_p -> resistance[0 + resistancesPosition];
    resistances_arr[7] = current_meas_p -> resistance[5 + resistancesPosition];
    resistances_arr[8] = current_meas_p -> resistance[10 + resistancesPosition];
  } else {
    first_resistances_id = ID_FIRST_COMMON_RESISTANCES_MEAS;
    last_resistances_id = ID_LAST_COMMON_RESISTANCES_MEAS;
    number_resistances = NUMBER_COMMON_RESISTANCES_MEAS;
    resistances_arr[0] = (int) ceil((current_meas_p -> resistance_m[0]) * 1000);
    resistances_arr[1] = (int) ceil((current_meas_p -> resistance_m[1]) * 1000);
    resistances_arr[2] = (int) ceil((current_meas_p -> resistance_m[2]) * 1000);
    resistances_arr[3] = (int) ceil((current_meas_p -> resistance_m[3]) * 1000);
    resistances_arr[4] = (int) ceil((current_meas_p -> resistance_m[4]) * 1000);
    resistances_arr[5] = (int) ceil((current_meas_p -> resistance_m[5]) * 1000);
    resistances_arr[6] = current_meas_p -> resistance[15];
    resistances_arr[7] = current_meas_p -> resistance[16];
    resistances_arr[8] = current_meas_p -> resistance[17];
  }
  
  int cnt = 0;
  char text[_TEXT_RESISTANCES_LENGTH_] = {0};
  int precision = 3;
  for (int id = first_resistances_id + 2 * number_resistances; id <= last_resistances_id; id++) {
    for (int j = 0; j < _TEXT_RESISTANCES_LENGTH_; j++) {
      text[j] = 0;
    }
    _PARSE_INT_TO_DOUBLE_STR(resistances_arr[cnt], precision, text);
    _CONCAT_STR(text, meas_item_units[ID_MEAS_RESISTANCES_PG][sel_language][cnt]);
    TEXT_SetText(WM_GetDialogItem(measMultiPageWin, id), text);
    
    cnt++;
  }
  
  #undef _TEXT_RESISTANCES_LENGTH_
}

void update_speed_resistance_change_pg() {
  #define _TEXT_SPEED_RESISTANCE_CHANGE_LENGTH_   13 //signe + max val + unit
  
  GetTotMeas(&gui_total_measurement);
  __TOTAL_MEASUREMENT* current_meas_p = &gui_total_measurement;
  
  int speed_resistance_changes_arr[NUMBER_SPEED_RESISTANCE_CHANGE_MEAS] = {
    current_meas_p -> speed_resistance_change[0],
    current_meas_p -> speed_resistance_change[5],
    current_meas_p -> speed_resistance_change[10],
    current_meas_p -> speed_resistance_change[1],
    current_meas_p -> speed_resistance_change[6],
    current_meas_p -> speed_resistance_change[11],
    current_meas_p -> speed_resistance_change[2],
    current_meas_p -> speed_resistance_change[7],
    current_meas_p -> speed_resistance_change[12],
    current_meas_p -> speed_resistance_change[3],
    current_meas_p -> speed_resistance_change[8],
    current_meas_p -> speed_resistance_change[13],
    current_meas_p -> speed_resistance_change[4],
    current_meas_p -> speed_resistance_change[9],
    current_meas_p -> speed_resistance_change[14],
    current_meas_p -> speed_resistance_change[15],
    current_meas_p -> speed_resistance_change[16],
    current_meas_p -> speed_resistance_change[17]
  };
  
  int cnt = 0;
  char text[_TEXT_SPEED_RESISTANCE_CHANGE_LENGTH_] = {0};
  int precision = 3;
  for (int id = ID_FIRST_SPEED_RESISTANCE_CHANGE_MEAS + 2 * NUMBER_SPEED_RESISTANCE_CHANGE_MEAS; id <= ID_LAST_SPEED_RESISTANCE_CHANGE_MEAS; id++) {
    for (int j = 0; j < _TEXT_SPEED_RESISTANCE_CHANGE_LENGTH_; j++) {
      text[j] = 0;
    }
    _PARSE_INT_TO_DOUBLE_STR(speed_resistance_changes_arr[cnt], precision, text);
    _CONCAT_STR(text, meas_item_units[ID_MEAS_SPEED_RESISTANCE_CHANGE_PG][sel_language][cnt]);
    TEXT_SetText(WM_GetDialogItem(measMultiPageWin, id), text);
    
    cnt++;
  }
  
  #undef _TEXT_SPEED_RESISTANCE_CHANGE_LENGTH_
}

void update_resistance_angle_pg() {
  #define _TEXT_RESISTANCE_ANGLE_LENGTH_   13 //signe + max val + unit
  
  GetTotMeas(&gui_total_measurement);
  __TOTAL_MEASUREMENT* current_meas_p = &gui_total_measurement;
  
  int resistance_angle_arr[NUMBER_RESISTANCE_ANGLE_MEAS] = {
    current_meas_p -> resistance_angle[0],
    current_meas_p -> resistance_angle[5],
    current_meas_p -> resistance_angle[10],
    current_meas_p -> resistance_angle[1],
    current_meas_p -> resistance_angle[6],
    current_meas_p -> resistance_angle[11],
    current_meas_p -> resistance_angle[2],
    current_meas_p -> resistance_angle[7],
    current_meas_p -> resistance_angle[12],
    current_meas_p -> resistance_angle[3],
    current_meas_p -> resistance_angle[8],
    current_meas_p -> resistance_angle[13],
    current_meas_p -> resistance_angle[4],
    current_meas_p -> resistance_angle[9],
    current_meas_p -> resistance_angle[14],
    current_meas_p -> resistance_angle[15],
    current_meas_p -> resistance_angle[16],
    current_meas_p -> resistance_angle[17]
  };
  
  int cnt = 0;
  char text[_TEXT_RESISTANCE_ANGLE_LENGTH_] = {0};
  for (int id = ID_FIRST_RESISTANCE_ANGLE_MEAS + 2 * NUMBER_RESISTANCE_ANGLE_MEAS; id <= ID_LAST_RESISTANCE_ANGLE_MEAS; id++) {
    for (int j = 0; j < _TEXT_RESISTANCE_ANGLE_LENGTH_; j++) {
      text[j] = 0;
    }
    _PARSE_INT_TO_STR(resistance_angle_arr[cnt], text);
    _CONCAT_STR(text, meas_item_units[ID_MEAS_RESISTANCE_ANGLE_PG][sel_language][cnt]);
    TEXT_SetText(WM_GetDialogItem(measMultiPageWin, id), text);
    
    cnt++;
  }
  
  #undef _TEXT_RESISTANCE_ANGLE_LENGTH_
}

void update_other_meas_pg() {
  #define _TEXT_OTHER_MEAS_LENGTH_   17 //signe + max val + point + precision + unit
  
  GetTotMeas(&gui_total_measurement);
  __TOTAL_MEASUREMENT* current_meas_p = &gui_total_measurement;
  
  long other_meas_arr[NUMBER_OTHER_MEAS] = {
    ((current_meas_p -> frequency_SPI1 < 0) ? -1 : ((long) ceil((current_meas_p -> frequency_SPI1) * 1000)) ),
    ((current_meas_p -> frequency_SPI2 < 0) ? -1 : ((long) ceil((current_meas_p -> frequency_SPI2) * 1000)) ),
    current_meas_p -> speed_angle_change,
    current_meas_p -> linear_current[0],
    current_meas_p -> linear_current[1],
    current_meas_p -> linear_current[2],
    current_meas_p -> linear_voltage[0],
    current_meas_p -> linear_voltage[1],
    current_meas_p -> linear_voltage[2],
    current_meas_p -> voltage_difference,
    current_meas_p -> U_line,
    current_meas_p -> active_power[0],
    current_meas_p -> active_power[1],
    current_meas_p -> active_power[2],
    current_meas_p -> reactive_power[0],
    current_meas_p -> reactive_power[1],
    current_meas_p -> reactive_power[2],
    current_meas_p -> full_power[0],
    current_meas_p -> full_power[1],
    current_meas_p -> full_power[2],
    current_meas_p -> sum_power[0],
    current_meas_p -> sum_power[1],
    current_meas_p -> sum_power[2],
    (long) ceil((current_meas_p -> power_coefficient[0]) * 1000),
    (long) ceil((current_meas_p -> power_coefficient[1]) * 1000),
    (long) ceil((current_meas_p -> power_coefficient[2]) * 1000),
    (long) ceil((current_meas_p -> active_power_plus) * 1000),
    (long) ceil((current_meas_p -> active_power_minus) * 1000),
    (long) ceil((current_meas_p -> reactive_power_1q) * 1000),
    (long) ceil((current_meas_p -> reactive_power_2q) * 1000),
    (long) ceil((current_meas_p -> reactive_power_3q) * 1000),
    (long) ceil((current_meas_p -> reactive_power_4q) * 1000)
  };
  
  int cnt = 0;
  int precision_arr[NUMBER_OTHER_MEAS] = {
    3, 3, 1, 3, 3, 3, 3, 3, 3, 3, 3, 3, 3, 3, 3, 3, 3, 3, 3, 3, 3, 3, 3, 3, 3, 3, 3, 3, 3, 3, 3
  };
  char text[_TEXT_OTHER_MEAS_LENGTH_] = {0};
  for (int id = ID_FIRST_OTHER_MEAS + 2 * NUMBER_OTHER_MEAS; id <= ID_LAST_OTHER_MEAS; id++) {
    for (int j = 0; j < _TEXT_OTHER_MEAS_LENGTH_; j++) {
      text[j] = 0;
    }
    if (precision_arr[cnt] == 1) {
      _PARSE_INT_TO_STR(other_meas_arr[cnt], text);
    } else {
      _PARSE_INT_TO_DOUBLE_STR(other_meas_arr[cnt], precision_arr[cnt], text);
    }
    _CONCAT_STR(text, meas_item_units[ID_MEAS_OTHER_PG][sel_language][cnt]);
    TEXT_SetText(WM_GetDialogItem(measMultiPageWin, id), text);
    
    cnt++;
  }
  
  #undef _TEXT_OTHER_MEAS_LENGTH_
}

void measurement_panel_init() {
  int frmWinWidth = GUI_X_MAX;
  int frmWinHeight = GUI_Y_MAX - 40;
  int x0 = 0;
  int y0 = 20;
  
  measMultiPageWin = FRAMEWIN_Create(measFrmText[sel_language], _cbMeasWin, WM_CF_SHOW, x0, y0, frmWinWidth, frmWinHeight);
  FRAMEWIN_SetFont(measMultiPageWin, &GUI_FontArialBold14_8_Unicode);
  FRAMEWIN_SetTitleVis(measMultiPageWin, 0/*hidden*/);
  
  measHMultiPage = MULTIPAGE_CreateEx(0, 0, frmWinWidth, frmWinHeight, WM_GetClientWindow(measMultiPageWin), WM_CF_SHOW, 0, 0);
  MULTIPAGE_SetFont(measHMultiPage, &GUI_FontArialBold14_8_Unicode);
  
  /* Create and attache the MULTIPAGE dialog windows */
  measPgs[ID_MEAS_FOURIER_PG] = GUI_CreateDialogBox(_aMeasPgCreate1,
                                GUI_COUNTOF(_aMeasPgCreate1),
                                &_cbDialog1, WM_UNATTACHED, 0, 0);
  for (int id = ID_FIRST_FOURIER_MEAS; id <= ID_LAST_FOURIER_MEAS; id++) {
    TEXT_SetFont(WM_GetDialogItem(measPgs[ID_MEAS_FOURIER_PG], id), &GUI_FontArialStandard14_8_Unicode);
  }
  MULTIPAGE_AddPage(measHMultiPage, measPgs[ID_MEAS_FOURIER_PG], _measItem[ID_MEAS_FOURIER_PG].pText[sel_language]);
  
  measPgs[ID_MEAS_SUM_EQUATION_PG] = GUI_CreateDialogBox(_aMeasPgCreate2,
                                GUI_COUNTOF(_aMeasPgCreate2),
                                &_cbDialog2, WM_UNATTACHED, 0, 0);
  for (int id = ID_FIRST_SUM_EQUATION_MEAS; id <= ID_LAST_SUM_EQUATION_MEAS; id++) {
    TEXT_SetFont(WM_GetDialogItem(measPgs[ID_MEAS_SUM_EQUATION_PG], id), &GUI_FontArialStandard14_8_Unicode);
  }
  MULTIPAGE_AddPage(measHMultiPage, measPgs[ID_MEAS_SUM_EQUATION_PG], _measItem[ID_MEAS_SUM_EQUATION_PG].pText[sel_language]);
  
  measPgs[ID_MEAS_ANGLES_PG] = GUI_CreateDialogBox(_aMeasPgCreate3,
                                GUI_COUNTOF(_aMeasPgCreate3),
                                &_cbDialog3, WM_UNATTACHED, 0, 0);
  for (int id = ID_FIRST_ANGLES_MEAS; id <= ID_LAST_ANGLES_MEAS; id++) {
    TEXT_SetFont(WM_GetDialogItem(measPgs[ID_MEAS_ANGLES_PG], id), &GUI_FontArialStandard14_8_Unicode);
  }
  MULTIPAGE_AddPage(measHMultiPage, measPgs[ID_MEAS_ANGLES_PG], _measItem[ID_MEAS_ANGLES_PG].pText[sel_language]);
  
  resistancesMulPg = MULTIPAGE_CreateEx(0, 0, frmWinWidth - 5, frmWinHeight, WM_GetClientWindow(measHMultiPage), WM_CF_SHOW, 0, 0);
  MULTIPAGE_SetFont(resistancesMulPg, &GUI_FontArialBold14_8_Unicode);
  MULTIPAGE_SetRotation(resistancesMulPg, MULTIPAGE_CF_ROTATE_CW);
  MULTIPAGE_SetBkColor(resistancesMulPg, GUI_USER_LIGHTGRAY, MULTIPAGE_CI_DISABLED);
  MULTIPAGE_SetBkColor(resistancesMulPg, GUI_BLUE, MULTIPAGE_CI_ENABLED);
  MULTIPAGE_SetTextColor(resistancesMulPg, GUI_BLACK, MULTIPAGE_CI_DISABLED);
  MULTIPAGE_SetTextColor(resistancesMulPg, GUI_YELLOW, MULTIPAGE_CI_ENABLED);
  measPgs[ID_MEAS_RESISTANCES_PG] = GUI_CreateDialogBox(_aMeasPgCreate5,
                                GUI_COUNTOF(_aMeasPgCreate5),
                                &_cbDialog4, WM_UNATTACHED, 0, 0);
  commonResistancesPg = GUI_CreateDialogBox(_aMeasPgCommonResistances,
                                GUI_COUNTOF(_aMeasPgCommonResistances),
                                &_cbCommonResistancesDialog, WM_UNATTACHED, 0, 0);
  for (int id = ID_FIRST_RESISTANCES_MEAS; id <= ID_LAST_RESISTANCES_MEAS; id++) {
    TEXT_SetFont(WM_GetDialogItem(measPgs[ID_MEAS_RESISTANCES_PG], id), &GUI_FontArialStandard14_8_Unicode);
  }
  for (int id = ID_FIRST_COMMON_RESISTANCES_MEAS; id <= ID_LAST_COMMON_RESISTANCES_MEAS; id++) {
    TEXT_SetFont(WM_GetDialogItem(commonResistancesPg, id), &GUI_FontArialStandard14_8_Unicode);
  }
  char strVal[1] = {0};
  for (int i = 0; i < MEAS_NUM_LEVEL_RESISTANCES; i++) {
    if (i < MEAS_NUM_LEVEL_RESISTANCES - 1) {
      _PARSE_INT_TO_STR((i + 1), strVal);
      MULTIPAGE_AddPage(resistancesMulPg, measPgs[ID_MEAS_RESISTANCES_PG], strVal);
    } else {
      MULTIPAGE_AddPage(resistancesMulPg, commonResistancesPg, commonText[sel_language]);
    }
    if (i > 0) MULTIPAGE_DisablePage(resistancesMulPg, i);
  }
  MULTIPAGE_SelectPage(resistancesMulPg, resistancesPosition);
  MULTIPAGE_AddPage(measHMultiPage, resistancesMulPg, _measItem[ID_MEAS_RESISTANCES_PG].pText[sel_language]);
  
  measPgs[ID_MEAS_SPEED_RESISTANCE_CHANGE_PG] = GUI_CreateDialogBox(_aMeasPgCreate6,
                                GUI_COUNTOF(_aMeasPgCreate6),
                                &_cbDialog5, WM_UNATTACHED, 0, 0);
  for (int id = ID_FIRST_SPEED_RESISTANCE_CHANGE_MEAS; id <= ID_LAST_SPEED_RESISTANCE_CHANGE_MEAS; id++) {
    TEXT_SetFont(WM_GetDialogItem(measPgs[ID_MEAS_SPEED_RESISTANCE_CHANGE_PG], id), &GUI_FontArialStandard14_8_Unicode);
  }
  for (int id = ID_MEAS_RES_SPEED_STAGE1_TEXT; id <= ID_MEAS_RES_SPEED_COMMON_TEXT; id++) {
    TEXT_SetFont(WM_GetDialogItem(measPgs[ID_MEAS_SPEED_RESISTANCE_CHANGE_PG], id), &GUI_FontArialBold14_8_Unicode);
  }
  MULTIPAGE_AddPage(measHMultiPage, measPgs[ID_MEAS_SPEED_RESISTANCE_CHANGE_PG], _measItem[ID_MEAS_SPEED_RESISTANCE_CHANGE_PG].pText[sel_language]);
  
  measPgs[ID_MEAS_RESISTANCE_ANGLE_PG] = GUI_CreateDialogBox(_aMeasResistAngle,
                                GUI_COUNTOF(_aMeasResistAngle),
                                &_cbResistanceAngle, WM_UNATTACHED, 0, 0);
  for (int id = ID_FIRST_RESISTANCE_ANGLE_MEAS; id <= ID_LAST_RESISTANCE_ANGLE_MEAS; id++) {
    TEXT_SetFont(WM_GetDialogItem(measPgs[ID_MEAS_RESISTANCE_ANGLE_PG], id), &GUI_FontArialStandard14_8_Unicode);
  }
  for (int id = ID_MEAS_RES_ANGLE_STAGE1_TEXT; id <= ID_MEAS_RES_ANGLE_COMMON_TEXT; id++) {
    TEXT_SetFont(WM_GetDialogItem(measPgs[ID_MEAS_RESISTANCE_ANGLE_PG], id), &GUI_FontArialBold14_8_Unicode);
  }
  MULTIPAGE_AddPage(measHMultiPage, measPgs[ID_MEAS_RESISTANCE_ANGLE_PG], _measItem[ID_MEAS_RESISTANCE_ANGLE_PG].pText[sel_language]);
  
  measPgs[ID_MEAS_OTHER_PG] = GUI_CreateDialogBox(_aMeasPgCreate7,
                                GUI_COUNTOF(_aMeasPgCreate7),
                                &_cbDialog6, WM_UNATTACHED, 0, 0);
  for (int id = ID_FIRST_OTHER_MEAS; id <= ID_LAST_OTHER_MEAS; id++) {
    TEXT_SetFont(WM_GetDialogItem(measPgs[ID_MEAS_OTHER_PG], id), &GUI_FontArialStandard14_8_Unicode);
  }
  measPgScroll = SCROLLBAR_CreateAttached(WM_GetClientWindow(measPgs[ID_MEAS_OTHER_PG]), SCROLLBAR_CF_VERTICAL);
  SCROLLBAR_SetNumItems(measPgScroll, NUMBER_OTHER_MEAS * MEAS_LABEL_HEIGHT);
  SCROLLBAR_SetPageSize(measPgScroll, NUMBER_SHOWING_OTHER_MEAS * MEAS_LABEL_HEIGHT);
  MULTIPAGE_AddPage(measHMultiPage, measPgs[ID_MEAS_OTHER_PG], _measItem[ID_MEAS_OTHER_PG].pText[sel_language]);
  
  MULTIPAGE_SetBkColor(measHMultiPage, GUI_USER_LIGHTGRAY, MULTIPAGE_CI_DISABLED);
  MULTIPAGE_SetBkColor(measHMultiPage, GUI_BLACK, MULTIPAGE_CI_ENABLED);
  MULTIPAGE_SetTextColor(measHMultiPage, GUI_BLACK, MULTIPAGE_CI_DISABLED);
  MULTIPAGE_SetTextColor(measHMultiPage, GUI_YELLOW, MULTIPAGE_CI_ENABLED);
  
  for (int i = 1; i < MAX_LEVEL_MEAS_PG; i++) MULTIPAGE_DisablePage(measHMultiPage, i);
}

static int direction = WITHOUT_DIRECTION;
void meas_scrolling_direction(int _direction) {
  direction = _direction;
}
void meas_scrolling() {
  int scroll_value;
  int num_items;
  int pg_size;
  switch (direction) {
    case UP:
      {
        scroll_value = SCROLLBAR_GetValue(measPgScroll);
        pg_size = SCROLLBAR_GetPageSize(measPgScroll);
        if (scroll_value >= pg_size) {
          SCROLLBAR_SetValue(measPgScroll, scroll_value - pg_size);
          for (int id = ID_FIRST_OTHER_MEAS; id <= ID_LAST_OTHER_MEAS; id++) {
            WM_MoveWindow(WM_GetDialogItem(measPgs[ID_MEAS_OTHER_PG], id), 0, pg_size + 1);
          }
        } else if (scroll_value > 0) {
          SCROLLBAR_SetValue(measPgScroll, 0);
          for (int id = ID_FIRST_OTHER_MEAS; id <= ID_LAST_OTHER_MEAS; id++) {
            WM_MoveWindow(WM_GetDialogItem(measPgs[ID_MEAS_OTHER_PG], id), 0, pg_size + 1);
          }
        }
        break;
      }
    case DOWN:
      {
        scroll_value = SCROLLBAR_GetValue(measPgScroll);
        pg_size = SCROLLBAR_GetPageSize(measPgScroll);
        num_items = SCROLLBAR_GetNumItems(measPgScroll);
        if (scroll_value + pg_size < num_items) {
          SCROLLBAR_SetValue(measPgScroll, scroll_value + pg_size);
          for (int id = ID_FIRST_OTHER_MEAS; id <= ID_LAST_OTHER_MEAS; id++) {
            WM_MoveWindow(WM_GetDialogItem(measPgs[ID_MEAS_OTHER_PG], id), 0, -(pg_size + 1));
          }
        }
        break;
      }
    default:
      return;
  }
  direction = WITHOUT_DIRECTION;
}

void select_meas_multipage(int index) {
  #define STAGE_NAME_LENGTH       25
  
  char stageNum[2] = {0};
  char stageName[STAGE_NAME_LENGTH] = {0};
  char editFullText[EDIT_TEXT_MAX_LEN] = {0};
  switch(current_ekran.index_position) {
    case ID_MEAS_RESISTANCES_PG:
      {
        if (resistancesPosition < MEAS_NUM_LEVEL_RESISTANCES - 1) {
          _PARSE_INT_TO_STR((resistancesPosition + 1), stageNum);
          _CONCAT_STR(stageName, stageText[sel_language]);
          _CONCAT_STR(stageName, " №");
          _CONCAT_STR(stageName, stageNum);
          _CONCAT_STR(stageName, ") ");
          _CONCAT_STR(editFullText, _measItem[index].pExplanation[sel_language]);
          _CONCAT_STR(editFullText, " (");
          _CONCAT_STR(editFullText, stageName);
        } else {
          _CONCAT_STR(editFullText, _measItem[index].pExplanation[sel_language]);
          _CONCAT_STR(editFullText, " (");
          _CONCAT_STR(editFullText, commonText[sel_language]);
          _CONCAT_STR(editFullText, ") ");
        }
        EDIT_SetText(hEdit, editFullText);
        break;
      }
    case ID_MEAS_SPEED_RESISTANCE_CHANGE_PG:
      {
        for (int i = 0; i < MEAS_NUM_LEVEL_RESISTANCES; i++) {
          if (i < MEAS_NUM_LEVEL_RESISTANCES - 1) {
            _PARSE_INT_TO_STR((i + 1), stageNum);
            _CONCAT_STR(stageName, stageText[sel_language]);
            _CONCAT_STR(stageName, " №");
            _CONCAT_STR(stageName, stageNum);
            _CONCAT_STR(stageName, ": ");
          } else {
            _CONCAT_STR(stageName, commonText[sel_language]);
            _CONCAT_STR(stageName, ": ");
          }
          TEXT_SetText(WM_GetDialogItem(measMultiPageWin, ID_MEAS_RES_SPEED_STAGE1_TEXT + i), stageName);
          for (int j = 0; j < STAGE_NAME_LENGTH; j++) {
            stageName[j] = '\0';
          }
        }
        EDIT_SetText(hEdit, _measItem[index].pExplanation[sel_language]);
        break;
      }
    case ID_MEAS_RESISTANCE_ANGLE_PG:
      {
        for (int i = 0; i < MEAS_NUM_LEVEL_RESISTANCES; i++) {
          if (i < MEAS_NUM_LEVEL_RESISTANCES - 1) {
            _PARSE_INT_TO_STR((i + 1), stageNum);
            _CONCAT_STR(stageName, stageText[sel_language]);
            _CONCAT_STR(stageName, " №");
            _CONCAT_STR(stageName, stageNum);
            _CONCAT_STR(stageName, ": ");
          } else {
            _CONCAT_STR(stageName, commonText[sel_language]);
            _CONCAT_STR(stageName, ": ");
          }
          TEXT_SetText(WM_GetDialogItem(measMultiPageWin, ID_MEAS_RES_ANGLE_STAGE1_TEXT + i), stageName);
          for (int j = 0; j < STAGE_NAME_LENGTH; j++) {
            stageName[j] = '\0';
          }
        }
        EDIT_SetText(hEdit, _measItem[index].pExplanation[sel_language]);
        break;
      }
    default:
      {
        EDIT_SetText(hEdit, _measItem[index].pExplanation[sel_language]);
        break;
      }
  }
  for (int i = 0; i < MAX_LEVEL_MEAS_PG; i++) {
    MULTIPAGE_SetText(measHMultiPage, _measItem[i].pText[sel_language], i);
    switch(i) {
      case ID_MEAS_RESISTANCES_PG:
        {
          MULTIPAGE_SetText(resistancesMulPg, commonText[sel_language], MEAS_NUM_LEVEL_RESISTANCES - 1);
          break;
        }
      default:break;
    }
  }
  for (int i = 0; i < MAX_LEVEL_MEAS_PG; i++) {
    if (MULTIPAGE_IsPageEnabled(measHMultiPage, i)) {
      MULTIPAGE_DisablePage(measHMultiPage, i);
      break;
    }
  }
  MULTIPAGE_EnablePage(measHMultiPage, index);
  MULTIPAGE_SelectPage(measHMultiPage, index);
  WM_HWIN hScroll = 0;
  WM_Obj * pWin = WM_LOCK_H(measHMultiPage);
  WM_HWIN hi = pWin->hFirstChild;
  GUI_UNLOCK_H(pWin);
  while (hi) {
    if (WM_GetId(hi) == GUI_ID_HSCROLL) {
      hScroll = hi;
      break;
    }
    pWin = WM_LOCK_H(hi);
    hi = pWin->hNext;
    GUI_UNLOCK_H(pWin);
  }
  SCROLLBAR_SetValue(hScroll, index);
  
  #undef STAGE_NAME_LENGTH
}

void select_meas_multipage_up_down() {
  for (int i = 0; i < MEAS_NUM_LEVEL_RESISTANCES; i++) {
    if (MULTIPAGE_IsPageEnabled(resistancesMulPg, i)) {
      MULTIPAGE_DisablePage(resistancesMulPg, i);
      break;
    }
  }
  MULTIPAGE_EnablePage(resistancesMulPg, resistancesPosition);
  MULTIPAGE_SelectPage(resistancesMulPg, resistancesPosition);
}
