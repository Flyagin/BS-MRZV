/*###ICF### Section handled by ICF editor, don't touch! ****/
/*-Editor annotation file-*/
/* IcfEditorFile="$TOOLKIT_DIR$\config\ide\IcfEditor\a_v1_0.xml" */
/*-Memory Regions-*/
define symbol __ICFEDIT_region_SRAM_start__ = 0x20000000;
define symbol __ICFEDIT_region_SRAM_end__   = 0x203FFFFF;
define symbol __ICFEDIT_region_RAM1_start__   = 0x304000;
define symbol __ICFEDIT_region_RAM1_end__     = 0x305FFF;
define symbol __ICFEDIT_region_IRAM_start__   = 0x300000;
define symbol __ICFEDIT_region_IRAM_end__     = 0x30FFFF;

define symbol __ICFEDIT_region_DDR2_start__ = 0x70000000;
define symbol __ICFEDIT_region_DDR2_end__   = 0x73FFFFFF;


define symbol __ICFEDIT_region_Fl_Code_start__      = 0x10000000 ;
define symbol __ICFEDIT_region_Fl_Code_end__        = 0x100fffff ;
define symbol __ICFEDIT_region_Fl_Code_NC_start__   = 0x10100000 ;
define symbol __ICFEDIT_region_Fl_Code_NC_end__     = 0x101fffff ;
/*
define symbol __ICFEDIT_region_SRAM_Code_start__      = 0x20000000;
define symbol __ICFEDIT_region_SRAM_Code_end__        = 0x200fffff;
define symbol __ICFEDIT_region_SRAM_Code_NC_start__   = 0x20100000;  
define symbol __ICFEDIT_region_SRAM_Code_NC_end__     = 0x201fffff;

define symbol __ICFEDIT_region_SRAM_Data_start__      = 0x20200000 ;
define symbol __ICFEDIT_region_SRAM_Data_end__        = 0x202FFFFF ;
define symbol __ICFEDIT_region_SRAM_Data_NC_start__   = 0x20300000 ; 
define symbol __ICFEDIT_region_SRAM_Data_NC_end__     = 0x203FFFFF ;
*/
/* More Desirable Variant
define symbol __ICFEDIT_region_SRAM_Data_start__      = 0x20000000 ;
define symbol __ICFEDIT_region_SRAM_Data_end__        = 0x202FFFFF ;/-*128K*-/
define symbol __ICFEDIT_region_SRAM_Data_NC_start__   = 0x20300000 ; 
define symbol __ICFEDIT_region_SRAM_Data_NC_end__     = 0x2031FFFF ;/-*128K*-/

define symbol __ICFEDIT_region_SRAM_Code_start__      = 0x20320000 ;
define symbol __ICFEDIT_region_SRAM_Code_end__        = 0x203Cffff ;/-* 640 K*-/
define symbol __ICFEDIT_region_SRAM_Code_NC_start__   = 0x203D0000 ;  
define symbol __ICFEDIT_region_SRAM_Code_NC_end__     = 0x203FFFFF; /-* 128K*-/
*/
define symbol __ICFEDIT_region_SRAM_Code_start__      = 0x20000000;
define symbol __ICFEDIT_region_SRAM_Code_end__        = 0x201fffff;

define symbol __ICFEDIT_region_SRAM_Data_start__      = 0x20200000 ;
define symbol __ICFEDIT_region_SRAM_Data_end__        = 0x202FFFFF ;

define symbol __ICFEDIT_region_SRAM_Code_NC_start__   = 0x20300000;/*0x20100000;  */
define symbol __ICFEDIT_region_SRAM_Code_NC_end__     = 0x203Cffff;
define symbol __ICFEDIT_region_SRAM_Data_NC_start__   = 0x203D0000 ; 
define symbol __ICFEDIT_region_SRAM_Data_NC_end__     = 0x203FFFFF ;



define symbol __ICFEDIT_region_DDR_Code_start__      = 0x70000000;
define symbol __ICFEDIT_region_DDR_Code_end__        = 0x703fffff;
define symbol __ICFEDIT_region_DDR_Code_NC_start__   = 0x70400000;  
define symbol __ICFEDIT_region_DDR_Code_NC_end__     = 0x704fffff;


define symbol __ICFEDIT_region_DDR_Data_start__      = 0x70500000 ;
define symbol __ICFEDIT_region_DDR_Data_end__        = 0x705FFFFF ;
define symbol __ICFEDIT_region_DDR_Data_NC_start__   = 0x70600000 ; 
define symbol __ICFEDIT_region_DDR_Data_NC_end__     = 0x706FFFFF ;

/*-Sizes-*/
define symbol __ICFEDIT_size_startup__  = 0x100;
define symbol __ICFEDIT_size_vectors__  = 0x100;
define symbol __ICFEDIT_size_cstack__   = 0x2000;
define symbol __ICFEDIT_size_sysstack__ = 0x60;
define symbol __ICFEDIT_size_irqstack__ = 0x60;
define symbol __ICFEDIT_size_fiqstack__ = (3*4);
define symbol __ICFEDIT_size_abtstack__ = (1*4);
define symbol __ICFEDIT_size_undstack__ = (1*4);
define symbol __ICFEDIT_size_heap__     = 0x0;
/*-Exports-*/
export symbol __ICFEDIT_region_SRAM_start__;
export symbol __ICFEDIT_region_DDR2_start__;
export symbol __ICFEDIT_region_IRAM_start__;
export symbol __ICFEDIT_region_IRAM_end__;
export symbol __ICFEDIT_size_startup__;
export symbol __ICFEDIT_size_vectors__;
export symbol __ICFEDIT_size_cstack__;
export symbol __ICFEDIT_size_sysstack__;
export symbol __ICFEDIT_size_irqstack__;
export symbol __ICFEDIT_size_fiqstack__;
export symbol __ICFEDIT_size_abtstack__;
export symbol __ICFEDIT_size_undstack__;
export symbol __ICFEDIT_size_heap__;
export symbol __ICFEDIT_region_RAM1_start__;
export symbol __ICFEDIT_region_RAM1_end__;
/**** End of ICF editor section. ###ICF###*/

define memory mem with size = 4G;
define region STA_region =   mem:[from __ICFEDIT_region_DDR_Code_start__  size __ICFEDIT_size_startup__];
//define region STA_region =   mem:[from __ICFEDIT_region_SRAM_start__  size __ICFEDIT_size_startup__];

define region SRAM_region = mem:[from __ICFEDIT_region_SRAM_start__ to __ICFEDIT_region_SRAM_end__];
define region VEC_region =   mem:[from __ICFEDIT_region_IRAM_start__ size __ICFEDIT_size_vectors__];
define region RAM_region =   mem:[from __ICFEDIT_region_IRAM_start__+__ICFEDIT_size_vectors__ to __ICFEDIT_region_IRAM_end__];
define region RAM1_region =  mem:[from __ICFEDIT_region_RAM1_start__ to __ICFEDIT_region_RAM1_end__];
define region DDR2_region = mem:[from __ICFEDIT_region_DDR2_start__ to __ICFEDIT_region_DDR2_end__];

define region Fl_Code_region      = mem:[from __ICFEDIT_region_Fl_Code_start__       to __ICFEDIT_region_Fl_Code_end__       ];
define region Fl_Code_NC_region   = mem:[from __ICFEDIT_region_Fl_Code_NC_start__    to __ICFEDIT_region_Fl_Code_NC_end__    ];
define region SRAM_Code_region    = mem:[from __ICFEDIT_region_SRAM_Code_start__     to __ICFEDIT_region_SRAM_Code_end__     ];
define region SRAM_Code_NC_region = mem:[from __ICFEDIT_region_SRAM_Code_NC_start__  to __ICFEDIT_region_SRAM_Code_NC_end__  ];
define region SRAM_Data_region    = mem:[from __ICFEDIT_region_SRAM_Data_start__     to __ICFEDIT_region_SRAM_Data_end__     ];
define region SRAM_Data_NC_region = mem:[from __ICFEDIT_region_SRAM_Data_NC_start__  to __ICFEDIT_region_SRAM_Data_NC_end__  ];

define region DDR_Code_region    = mem:[from __ICFEDIT_region_DDR_Code_start__ + __ICFEDIT_size_startup__    to __ICFEDIT_region_DDR_Code_end__     ];
define region DDR_Code_NC_region = mem:[from __ICFEDIT_region_DDR_Code_NC_start__  to __ICFEDIT_region_DDR_Code_NC_end__  ];
define region DDR_Data_region    = mem:[from __ICFEDIT_region_DDR_Data_start__     to __ICFEDIT_region_DDR_Data_end__     ];
define region DDR_Data_NC_region = mem:[from __ICFEDIT_region_DDR_Data_NC_start__  to __ICFEDIT_region_DDR_Data_NC_end__  ];

define block CSTACK    with alignment = 8, size = __ICFEDIT_size_cstack__   { };
define block SYS_STACK with alignment = 8, size = __ICFEDIT_size_sysstack__ { };
define block IRQ_STACK with alignment = 8, size = __ICFEDIT_size_irqstack__ { };
define block FIQ_STACK with alignment = 8, size = __ICFEDIT_size_fiqstack__ { };
define block ABT_STACK with alignment = 8, size = __ICFEDIT_size_abtstack__ { };
define block UND_STACK with alignment = 8, size = __ICFEDIT_size_undstack__ { };
define block HEAP      with alignment = 8, size = __ICFEDIT_size_heap__     { };
/*
keep { section MYOVERLAY1,section MYOVERLAY2 };
/*
define overlay MYOVERLAY { section MYOVERLAY1 };
define overlay MYOVERLAY { section MYOVERLAY2 };
*/
initialize manually { section MYOVERLAY1, section MYOVERLAY2 };


initialize by copy { section .vectors };
initialize by copy { readwrite };
initialize by copy with packing = zeros { section Fastest_function };
initialize by copy with packing = zeros { section Fast_function };
initialize by copy with packing = zeros { section Fast_function_nc };

do not initialize  { section .noinit };
do not initialize  { section MMU_TT };

place in STA_region { section .cstartup };
place in VEC_region { section .vectors };

define block CHECKSUM { ro section .checksum };
/*
place at end of RAM_region {block SYS_STACK,block FIQ_STACK, block UND_STACK, block ABT_STACK, block IRQ_STACK};
place in RAM1_region {section Fast_variable, section Fastest_function};
place in SRAM_region {section Fast_function,readwrite};
place at end of SRAM_region {block CSTACK, block HEAP };
place in DDR2_region {readonly,zeroinit,  section DDR2_variables};
*/

place at end of RAM_region {
readwrite data section MMU_TT ,
block SYS_STACK,block FIQ_STACK, block UND_STACK, block ABT_STACK, block IRQ_STACK};
place in RAM1_region {section Fast_variable, section Fastest_function};
place in DDR_Code_region {  readonly};
place in SRAM_Code_region {section Fast_function }; 
place in SRAM_Data_region {  zeroinit,readwrite}; 
 
place in SRAM_Code_NC_region {section MYOVERLAY1_init, section MYOVERLAY2_init,
section Fast_function_nc,};
 
place at end of SRAM_Data_NC_region {
readwrite data section DMA_BUFFERS, 
						block CSTACK, block HEAP };


/*place in DDR2_region {readonly, section DDR2_variables};*/
place in DDR_Code_region {  };
place in DDR_Data_region {   };//section DDR2_variables
place in DDR_Code_NC_region { block CHECKSUM };